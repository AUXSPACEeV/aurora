## lib/state/Kconfig
```kconfig
# Copyright (c) 2025-2026 Auxspace e.V.
# SPDX-License-Identifier: Apache-2.0

config AURORA_STATE_MACHINE
	bool "Support for state machine"
	help
		This option enables functionality for the aurora state machine
		lib.

if AURORA_STATE_MACHINE

module = STATE_MACHINE
module-str = STATE_MACHINE
source "subsys/logging/Kconfig.template.log_config"

choice AURORA_STATE_MACHINE_TYPE
	bool "State Machine Type"
	depends on AURORA_STATE_MACHINE
	default SIMPLE_STATE

config SIMPLE_STATE
	bool "Simple State machine"
	help
		Simple State machine with apogee detection, single pyro ignition
		and basic safety features.
		Ideal for small form factor boards and rockets.

endchoice

config AURORA_STATE_MACHINE_RBF
	bool "Remove-before-flight arm input"
	depends on GPIO
	help
	  Take the arm signal from the mechanical safety interlock -
	  streamer, key or shorting plug - on the GPIO selected by the
	  auxspace,rbf dt chosen node, instead of from the application.
	  The line is asserted while the interlock is installed (safe); the
	  vehicle counts as armed once it is pulled.  When enabled, the pin
	  overrides sm_inputs.armed on every update.

config AURORA_STATE_MACHINE_RBF_DEBOUNCE_MS
	int "RBF input debounce window (ms)"
	default 50
	range 0 5000
	depends on AURORA_STATE_MACHINE_RBF
	help
	  Time the RBF contact has to stay quiet before a change is taken as
	  real.  Every edge restarts the window, so a chattering plug cannot
	  arm and disarm the machine repeatedly.

config AURORA_STATE_MACHINE_AUDIT
	bool "State machine audit log"
	default y if AURORA_STATE_MACHINE && CONFIG_FILE_SYSTEM
	help
	  Enable a ring-buffer audit log that records timestamped state
	  transitions and notable events.  Useful for post-flight analysis
	  and shell diagnostics.

config AURORA_STATE_MACHINE_AUDIT_LOG_SIZE
	int "Maximum number of audit log entries"
	default 32
	depends on AURORA_STATE_MACHINE_AUDIT
	help
	  Size of the ring buffer used for the audit log.  Oldest entries
	  are silently overwritten when full.

config AURORA_STATE_MACHINE_AUDIT_BASE_PATH
	string "Output directory for state machine audit files"
	default "/state"
	depends on AURORA_STATE_MACHINE_AUDIT
	help
	  Directory where the state machine audit writes output files.
	  The final path is <base_path>/audit.<index>.

config AURORA_STATE_MACHINE_AUDIT_MAX_FILES
	int "Maximum number of files in AURORA_STATE_MACHINE_AUDIT_BASE_PATH"
	default 200
	depends on AURORA_STATE_MACHINE_AUDIT
	help
	  Maximum number of files in the directory where the audit writes
	  output files.
	  If the maximum is reached, old files are overwritten.

config AURORA_STATE_MACHINE_SHELL
	bool "State machine shell commands"
	depends on SHELL
	help
	  Enable shell commands for inspecting state machine type,
	  current state, forcing transitions, viewing the audit log and
	  editing the flight thresholds.

config AURORA_STATE_MACHINE_CONFIG_STORE
	bool "Persist flight thresholds in flash"
	depends on FLASH
	select CRC
	default y
	help
	  Keep the flight thresholds in the flash partition selected by the
	  'auxspace,sm-config' chosen node, so a set made over the shell
	  survives a reboot.  The partition must be exactly one erase page.
	  Without the chosen node the thresholds stay at their Kconfig
	  values and saving reports -ENOTSUP.

menu "Flight thresholds (defaults)"

comment "Factory defaults - the running values can be changed at"
comment "runtime and are persisted, see the state_machine shell."

config BOOST_ACCELERATION
	int "Boost detection acceleration threshold"
	default 30
	help
		Acceleration threshold in m/s^2 for boost detection.

config BOOST_ALTITUDE
	int "Boost detection altitude threshold"
	default 50
	help
		Altitude threshold in meters for boost detection.

config BURNOUT_ACCELERATION
	int "Burnout detection acceleration threshold"
	default 15
	help
		Acceleration threshold in m/s^2 for burnout detection.

config MAIN_DESCENT_HEIGHT
	int "Main PYRO event height threshold"
	default 200
	help
		Descent height threshold in meters for MAIN Pyro event.

config LANDING_VELOCITY
	int "Velocity threshold for landing detection"
	default 2
	help
		Velocity threshold in m/s for landing detection.

config ARM_ANGLE
	int "Angle threshold for arming"
	default 85
	help
		Angle threshold in degrees for arming the system.
		0 degrees is horizontal, 90 degrees is vertical.

config DISARM_ANGLE
	int "Angle threshold for disarming"
	default 30
	help
		Angle threshold in degrees for disarming the system.
		0 degrees is horizontal, 90 degrees is vertical.

config DISARM_ANGLE_SAMPLES
	int "Number of disarm angle samples"
	default 10
	range 1 1000
	help
		Number of consecutive samples with angle < DISARM_ANGLE to
		disarm.

config BOOST_TIMER_MS
	int "Boost timer duration"
	default 900
	help
		Boost timer duration in milliseconds.
		Both BOOST_ACCELERATION and BOOST_ALTITUDE must be reached and held
		asserted during this time.

config LANDING_TIMER_MS
	int "Landing timer duration"
	default 500
	help
		Landing timer duration in milliseconds.
		LANDING_VELOCITY must be reached and held asserted during this time.

config APOGEE_TIMEOUT_MS
	int "Apogee timeout duration"
	default 60000
	help
		Time after which the APOGEE state returns to IDLE in milliseconds,
		if no further state changes occur.

config MAIN_TIMEOUT_MS
	int "Main to REDUNDANT duration"
	default 2000
	help
		Time after which the redundand pyro channel is fired after MAIN in
		milliseconds.

config REDUNDANT_TIMEOUT_MS
	int "Redundant timeout duration"
	default 900000
	help
		Time after which the REDUNDANT state returns to IDLE in milliseconds,
		if no further state changes occur.

endmenu

endif
```

## lib/telemetry/Kconfig
```kconfig
# Copyright (c) 2026 Auxspace e.V.
# SPDX-License-Identifier: Apache-2.0

config AURORA_TELEMETRY
	bool "Telemetry downlink"
	help
	  Enable the telemetry subsystem. Each registered backend
	  (plain UART link, HC-12, ...) receives every outgoing message.

if AURORA_TELEMETRY

module = AURORA_TELEMETRY
module-str = AURORA_TELEMETRY
source "subsys/logging/Kconfig.template.log_config"

config AURORA_TELEMETRY_UART_LINK_ENGINE
	bool
	depends on SERIAL
	select CRC
	help
	  The transport engine behind every UART-based backend: payload
	  packing, wire framing, rate limiting and the transmit worker.
	  Not selectable on its own - backends select it.

menu "Plain UART link"

config AURORA_TELEMETRY_UART_LINK
	bool "Telemetry over a plain UART"
	depends on SERIAL
	select AURORA_TELEMETRY_UART_LINK_ENGINE
	default y if DT_HAS_AUXSPACEEV_TELEMETRY_UART_LINK_ENABLED
	help
	  Write frames to the UART of an enabled
	  auxspaceev,telemetry-uart-link node. For a peer that already
	  speaks the telemetry wire format and needs no provisioning:
	  an AUX-Tel relay on the stack data connector, or a laptop on
	  a USB-serial adapter.

if AURORA_TELEMETRY_UART_LINK

config AURORA_TELEMETRY_UART_LINK_QUEUE_DEPTH
	int "UART link TX frame queue depth"
	default 8
	range 1 128
	help
	  Frames buffered between the producer and the UART worker
	  thread. A full queue returns -ENOMEM (frame dropped) and
	  never blocks the producer.

config AURORA_TELEMETRY_UART_LINK_MIN_INTERVAL_MS
	int "Minimum interval between UART link SM update frames (ms)"
	default 0
	range 0 10000
	help
	  Lower bound between consecutive SM updates. Calls arriving
	  sooner return -EAGAIN and are dropped. 0 for no rate limit,
	  which is the sensible default on a wired link - let the peer
	  decide what to do with the data.

config AURORA_TELEMETRY_UART_LINK_STACK_SIZE
	int "UART link TX worker stack size (bytes)"
	default 1024

config AURORA_TELEMETRY_UART_LINK_THREAD_PRIORITY
	int "UART link TX worker thread priority"
	default 10
	help
	  Keep numerically above flight-critical threads (sensors and
	  state machine run at priority 5-6) so telemetry can never
	  preempt them.

endif # AURORA_TELEMETRY_UART_LINK

endmenu # Plain UART link

menu "HC-12"

config AURORA_TELEMETRY_HC12
	bool "HC-12 433 MHz transparent UART bridge"
	depends on SERIAL
	select GPIO
	select AURORA_TELEMETRY_UART_LINK_ENGINE
	default y if DT_HAS_AUXSPACEEV_HC12_ENABLED
	help
	  Push frames over the UART of an enabled auxspaceev,hc12 node.
	  The module is provisioned out of band on the bench (channel,
	  air baud, TX power) or, when SET is wired and the shell is
	  enabled, via the "telemetry hc12" shell command tree.

if AURORA_TELEMETRY_HC12

config AURORA_TELEMETRY_HC12_QUEUE_DEPTH
	int "HC-12 TX frame queue depth"
	default 16
	range 1 128
	help
	  Number of frames buffered between the producer and the UART
	  worker thread. Full queue -> -ENOMEM (frame dropped); never
	  blocks the producer.

config AURORA_TELEMETRY_HC12_MIN_INTERVAL_MS
	int "Minimum interval between HC-12 SM update frames (ms)"
	default 0
	range 0 10000
	help
	  Lower bound between consecutive SM updates transmitted via
	  HC-12. Calls arriving sooner return -EAGAIN and are dropped.
	  Set to 0 for no rate limit.

config AURORA_TELEMETRY_HC12_STACK_SIZE
	int "HC-12 TX worker stack size (bytes)"
	default 1024

config AURORA_TELEMETRY_HC12_THREAD_PRIORITY
	int "HC-12 TX worker thread priority"
	default 10
	help
	  Keep numerically above flight-critical threads (sensors and
	  state machine run at priority 5-6) so telemetry can never
	  preempt them.

config AURORA_TELEMETRY_HC12_AT
	bool "AT-mode helper (runtime configuration)"
	default y if AURORA_TELEMETRY_HC12_SHELL
	help
	  Compile in the synchronous AT-command helper that drives the
	  HC-12 SET pin and exchanges AT commands at 9600 baud. Required
	  by the shell; can be enabled standalone for application use.
	  Inert at runtime if the DT node has no set-gpios property.

config AURORA_TELEMETRY_HC12_SHELL
	bool "HC-12 provisioning shell"
	depends on SHELL
	depends on AURORA_STATE_MACHINE
	select AURORA_TELEMETRY_HC12_AT
	help
	  Register the "telemetry hc12" command tree: info, channel,
	  baud, power, mode, reset, and a raw AT escape hatch. All
	  commands refuse to run unless the flight state machine is
	  in IDLE.

endif # AURORA_TELEMETRY_HC12

endmenu # HC-12

endif # AURORA_TELEMETRY
```

## lib/watchdog/Kconfig
```kconfig
# Copyright (c) 2026 Auxspace e.V.
# SPDX-License-Identifier: Apache-2.0

config AURORA_WATCHDOG
	bool "Hardware watchdog supervision"
	select WATCHDOG
	select TASK_WDT
	select TASK_WDT_HW_FALLBACK
	help
	  Reset the board when the kernel stops running.  A dedicated thread
	  feeds a task watchdog channel; if it stops being scheduled, the
	  board resets.

	  This supervises kernel liveness only, not sensor data flow.  A
	  sensor that goes quiet is a degraded flight to fly through, not a
	  reason to reboot -- and since an I2C wedge survives a warm reset,
	  supervising sensor flow produces a reset loop rather than a
	  recovery.

	  TASK_WDT_HW_FALLBACK is what makes this work against the failures
	  worth catching: the task watchdog runs off the kernel timer, so a
	  stopped kernel clock stops the supervisor too.  The hardware
	  watchdog behind it has its own clock.

	  Pair with AURORA_STATE_MACHINE_RETAIN so the reset resumes the
	  flight instead of rebooting into a disarmed vehicle.

if AURORA_WATCHDOG

config AURORA_WATCHDOG_TIMEOUT_MS
	int "Watchdog timeout (ms)"
	default 2000
	range 100 60000
	help
	  How long the feeder thread may go unscheduled before the board is
	  reset.  Keep it comfortably above the feed interval so ordinary
	  scheduling jitter, logging bursts and flash writes do not trip it.

config AURORA_WATCHDOG_FEED_INTERVAL_MS
	int "Feed interval (ms)"
	default 500
	range 10 30000
	help
	  How often the feeder thread feeds the channel.  Should be a good
	  fraction of AURORA_WATCHDOG_TIMEOUT_MS so a single missed cycle
	  does not reset the board.

config AURORA_WATCHDOG_HW_TIMEOUT_MS
	int "Hardware backstop timeout (ms)"
	default 1000
	range 200 30000
	help
	  How long the hardware watchdog may go unfed before it bites.

config AURORA_WATCHDOG_PRIORITY
	int "Feeder thread priority"
	default 10
	help
	  Priority of the feeder thread.  A preemptible priority is
	  intentional: if a higher-priority thread spins and starves
	  everything below it, the board is not doing useful work and the
	  reset is the correct outcome.

config AURORA_WATCHDOG_STACK_SIZE
	int "Feeder thread stack size"
	default 1024
	help
	  Stack for the feeder thread.  It only calls task_wdt_feed() and
	  k_sleep(), but on Xtensa any interrupt taken while it runs pushes a
	  save area plus spilled registers onto this stack.

module = AURORA_WATCHDOG
module-str = Aurora watchdog
source "subsys/logging/Kconfig.template.log_config"

endif # AURORA_WATCHDOG
```

## sensor_board/boards/micrometer_esp32s3_procpu_1.conf
```kconfig
# Copyright (c) 2026 Auxspace e.V.
# SPDX-License-Identifier: Apache-2.0

CONFIG_LPS22HH=y
```

## west.yml
```yaml
# Copyright (c) 2021 Nordic Semiconductor ASA
# SPDX-License-Identifier: Apache-2.0

manifest:
  remotes:
    - name: zephyr-rtos
      url-base: https://github.com/zephyrproject-rtos
    - name: auxspace-forked
      url-base: https://github.com/AUXSPACEeV
  defaults:
    remote: auxspace-forked
  projects:
    - name: zephyr
      remote: auxspace-forked
      revision: 9691e9ae8bf6563269a0ac8b87eada0da9ca2703
      import:
        # By using name-allowlist we can clone only the modules that are
        # strictly needed by the application.
        name-allowlist:
          - zephyr
          - cmsis_6    # required by the ARM port for Cortex-M
          - hal_rpi_pico   # required by the rpi_pico boards (raspberrypi based)
          - hal_st   # required for st sensors
          - hal_espressif # required for ESP32
          - fatfs      # required for filesystem operations (ff.h)
          - mcuboot    # required as bootloader for ESP32
          - mbedtls       # required by BT host crypto (pad_link / BLE)
          - tf-psa-crypto # PSA crypto provider used by mbedtls
```
