## boards/auxspace/AUX-Core/esp32s3/Kconfig.core65
```kconfig
# Copyright (c) 2024 Espressif Systems (Shanghai) Co., Ltd.
# Copyright (c) 2026 Auxspace e.V.
# SPDX-License-Identifier: Apache-2.0

config BOARD_CORE65
	select SOC_ESP32S3_WROOM_N8
	select SOC_ESP32S3_PROCPU if BOARD_CORE65_ESP32S3_PROCPU
```

## boards/auxspace/AUX-Core/esp32s3/board.yml
```yaml
# SPDX-License-Identifier: Apache-2.0
#
# Copyright (c) 2026 Auxspace e.V.

board:
  name: core65
  full_name: AUX-Core 65
  vendor: auxspaceev
  revision:
    format: number
    default: "1"
    revisions:
    - name: "1"
  socs:
  - name: esp32s3
```

## boards/auxspace/AUX-Tel/stm32wl/Kconfig.tel65
```kconfig
# Copyright (c) 2026 Auxspace e.V.
# SPDX-License-Identifier: Apache-2.0

config BOARD_TEL65
	select SOC_STM32WLE5XX
```

## boards/auxspace/AUX-Tel/stm32wl/board.yml
```yaml
# SPDX-License-Identifier: Apache-2.0
#
# Copyright (c) 2026 Auxspace e.V.

board:
  name: tel65
  full_name: AUX-Tel 65
  vendor: auxspaceev
  revision:
    format: number
    default: "1"
    revisions:
    - name: "1"
  socs:
  - name: stm32wle5xx
```

## boards/auxspace/flight_computer_v2/board.yml
```yaml
board:
  name: flight_computer_v2
  full_name: Flight Computer V2
  vendor: auxspaceev
  socs:
    - name: rp2040
      variants:
        - name: w
    - name: rp2350a
      variants:
        - name: w
          cpucluster: m33
```

## drivers/sensor/Kconfig
```kconfig
# Copyright (c) 2026 Auxspace e.V.
# SPDX-License-Identifier: Apache-2.0

if SENSOR

rsource "adxl375/Kconfig"
rsource "mlx90395/Kconfig"

endif # SENSOR
```

## drivers/sensor/adxl375/Kconfig
```kconfig
# Copyright (c) 2026 Auxspace e.V.
# SPDX-License-Identifier: Apache-2.0

config ADXL375
	bool "ADXL375 high-g accelerometer"
	default y
	depends on DT_HAS_ADI_ADXL375_ENABLED
	select I2C
	help
	  Enable driver for the Analog Devices ADXL375 3-axis +-200 g
	  accelerometer.
```

## drivers/sensor/ceva/bno08x/Kconfig
```kconfig
# Copyright (c) 2026 Auxspace e.V.
# SPDX-License-Identifier: MIT

config CEVA_BNO08X
	bool "CEVA BNO08x (BNO080/085/086) 9-DoF IMU"
	default y
	depends on DT_HAS_CEVA_BNO08X_ENABLED
	depends on SENSOR
	depends on SPI
	help
	  Enable the CEVA BNO08x sensor-hub driver (BNO080/085/086) over SPI.
	  The device runs CEVA's SH-2 fusion firmware and communicates with the
	  SHTP protocol; this driver vendors CEVA's sh2 library and exposes the
	  accelerometer, calibrated gyroscope and calibrated magnetic-field
	  reports through the standard Zephyr sensor API
	  (SENSOR_CHAN_ACCEL_XYZ / GYRO_XYZ / MAGN_XYZ).
```

## drivers/sensor/mlx90395/Kconfig
```kconfig
# Copyright (c) 2026 Auxspace e.V.
# SPDX-License-Identifier: Apache-2.0

config MLX90395
	bool "MLX90395 3-axis magnetometer"
	default y
	depends on DT_HAS_MELEXIS_MLX90395_ENABLED
	select I2C
	select CRC
	help
	  Enable driver for the Melexis MLX90395 3-axis magnetometer, in
	  both its 50 mT and 120 mT variants.
```

## dts/bindings/sensor/adi,adxl375.yaml
```yaml
# Copyright (c) 2026 Auxspace e.V.
# SPDX-License-Identifier: Apache-2.0

description: |
  Analog Devices ADXL375 3-axis +-200 g accelerometer on I2C.

  Register compatible with the ADXL345, but with a fixed +-200 g range
  at 49 mg/LSB.

compatible: "adi,adxl375"

include: [sensor-device.yaml, i2c-device.yaml]

properties:
  odr:
    type: int
    default: 100
    description: |
      Output data rate in Hz. The default is the power-on reset value.
      The datasheet recommends a 400 kHz bus for 800 Hz and SPI for
      1600 Hz and above when every sample is read.
    enum: [25, 50, 100, 200, 400, 800, 1600, 3200]

  int1-gpios:
    type: phandle-array
    description: INT1 pin. Not used by the driver yet.

  int2-gpios:
    type: phandle-array
    description: INT2 pin. Not used by the driver yet.
```

## dts/bindings/sensor/ceva,bno08x.yaml
```yaml
# Copyright (c) 2024 Sensorimotor Learning Lab (SML-Posey), MIT-licensed.
# Copyright (c) 2026 Auxspace e.V.
# SPDX-License-Identifier: MIT
#
# Vendored from SML-Posey/posey-firmware and adapted for AURORA:
#   - ps1-gpios is now optional (PS1 may be strapped high in hardware for a
#     static SPI-mode select when a spare MCU GPIO is not available), and
#   - report-interval-us configures the accel/gyro/mag report rate.

description: |
  CEVA BNO08x (BNO080 / BNO085 / BNO086) 9-DoF sensor hub, SPI interface.

  The BNO08x runs CEVA's SH-2 fusion firmware and speaks the SHTP protocol.
  In SPI mode the protocol-select straps must be PS1=1, PS0=1; PS0 doubles as
  the host wake (H_WAKE) line. The driver drives PS0 (and PS1 when wired) and
  toggles the interrupt (H_INTN) and reset lines.

compatible: "ceva,bno08x"

include: ["spi-device.yaml", "sensor-device.yaml"]

properties:
  int-gpios:
    type: phandle-array
    required: true
    description: |
      Connection for the active-LOW host interrupt (H_INTN / nINT).
  reset-gpios:
    type: phandle-array
    required: true
    description: |
      Connection for the active-LOW hardware reset (nRESET).
  ps0-gpios:
    type: phandle-array
    required: true
    description: |
      Connection for protocol-select pin 0 (PS0). In SPI mode PS0 also serves
      as the host wake (H_WAKE) line, so it must be an MCU GPIO.
  ps1-gpios:
    type: phandle-array
    required: false
    description: |
      Connection for protocol-select pin 1 (PS1). Optional: omit this when PS1
      is strapped high in hardware for a static SPI-mode select. When present,
      the driver drives it high at init.
  report-interval-us:
    type: int
    default: 10000
    description: |
      Interval, in microseconds, between input reports requested from the hub
      for the accelerometer, calibrated gyroscope and calibrated magnetic
      field. Default 10000 (100 Hz); set at or above the consumer's poll rate.
```

## dts/bindings/sensor/melexis,mlx90395.yaml
```yaml
# Copyright (c) 2026 Auxspace e.V.
# SPDX-License-Identifier: Apache-2.0

description: |
  Melexis MLX90395 3-axis magnetometer on I2C.

  Not compatible with the MLX90394: the MLX90395 is driven by commands
  written to address 0x80 and has no identification register. Both the
  medium-field (50 mT) and high-field (120 mT) variants are supported; the
  driver tells them apart by their factory gain setting.

  Each fetch runs one single measurement of X, Y, Z and temperature. With
  OSR the oversampling and DF the digital filter, one conversion takes
  about 165 + 163 + 3 * (67 + 32 * 2^OSR * (2 + 2^DF)) + 11 us, i.e.
  0.8 ms with the defaults and 100 ms with both at maximum.

compatible: "melexis,mlx90395"

include: [sensor-device.yaml, i2c-device.yaml]

properties:
  resolution:
    type: int
    default: 1
    enum: [0, 1, 2, 3]
    description: |
      Which 16 bits of the 19-bit ADC value are output for X, Y and Z.
      Each step up doubles the field per LSB. The default is the factory
      setting, which gives 2.5 uT/LSB on the 50 mT variant and 7.14 uT/LSB
      on the 120 mT variant.

  oversampling:
    type: int
    default: 0
    enum: [0, 1, 2, 3]
    description: |
      ADC oversampling ratio of the magnetic measurement, as 2^n. The
      default is the factory setting.

  digital-filter:
    type: int
    default: 0
    enum: [0, 1, 2, 3, 4, 5, 6, 7]
    description: |
      Averaging filter of the magnetic measurement, over 2^n ADC
      conversions. The default is the factory setting.

  int-gpios:
    type: phandle-array
    description: INT/TRG pin. Not used by the driver yet.
```

## lib/communication/Kconfig
```kconfig
# Copyright (c) 2026 Auxspace e.V.
# SPDX-License-Identifier: Apache-2.0

config AURORA_CAN_LOCAL
	bool "Enable local CAN loopback"
	depends on CAN
	help
	  Enabels the local CAN loopback for testing purposes
```

## lib/powerfail/Kconfig
```kconfig
# Copyright (c) 2026 Auxspace e.V.
# SPDX-License-Identifier: Apache-2.0

config AURORA_POWERFAIL
	bool "Powerfail mitigation subsystem"
	help
	  Enable the powerfail mitigation subsystem.
	  When enabled, aurora will stop file i/o to protect memory cards and
	  perform configured powerfail actions (e.g. shutdown).
	  The GPIO trigger is configured in the auxspace,pfm dt chosen node.
	  Needs a supply supervisor or comparator that asserts the line while
	  power is failing; an ADC cannot raise an interrupt on a threshold.

if AURORA_POWERFAIL

module = AURORA_POWERFAIL
module-str = AURORA_POWERFAIL
source "subsys/logging/Kconfig.template.log_config"

config AURORA_POWERFAIL_SHUTDOWN
	bool "Shut down on powerfail"
	depends on AURORA_POWERFAIL
	select POWEROFF

endif # AURORA_POWERFAIL
```

## lib/sensor/Kconfig
```kconfig
# Copyright (c) 2025-2026 Auxspace e.V.
# SPDX-License-Identifier: Apache-2.0

module = AURORA_SENSORS
module-str = AURORA_SENSORS
source "subsys/logging/Kconfig.template.log_config"

config AURORA_SENSORS
	bool "Support for sensor HAL"
	default y if SENSOR
	help
		This option enables functionality for the aurora sensor HAL.

config AURORA_FAKE_SENSORS
	bool "Simulated IMU/baro sample source (no hardware)"
	depends on AURORA_SENSORS
	depends on AURORA_STATE_MACHINE
	depends on SHELL
	help
	  Replace the hardware sample source in imu.c and baro.c with a
	  synthetic flight profile. Only the source changes: the sensors are
	  read on the same schedule and publish on the same zbus channels, so
	  the whole data path, attitude tracker, filter and state machine can
	  be exercised without real sensors. IMU_FREQUENCY and BARO_FREQUENCY
	  set the rate as usual. Works on native_sim and on real hardware --
	  use the `sim` snippet (`west build -S sim ...`) to layer it on top
	  of any board. The `sim launch` shell command starts the flight.

config AURORA_FAKE_SENSORS_REPLAY
	bool "Replay a recorded flight instead of the synthetic profile"
	depends on IMU && BARO
	select AURORA_FAKE_SENSORS
	help
	  Swap the synthetic profile for playback of a real flight, embedded
	  at build time from a recorded flights.csv. Pre-launch it holds the
	  first recorded sample so attitude calibration converges as usual;
	  `sim launch` then plays the recording back against its original
	  timeline, each read returning the newest sample whose timestamp has
	  passed. Implies AURORA_FAKE_SENSORS.

config AURORA_FAKE_SENSORS_SYNTH
	def_bool AURORA_FAKE_SENSORS && !AURORA_FAKE_SENSORS_REPLAY
	help
	  Internal switch: true when the simulated source should be the
	  synthetic flight profile rather than a recorded flight.

config AURORA_FAKE_SENSORS_REPLAY_INPUT
	string "Path to flights.csv used by the replay source"
	depends on AURORA_FAKE_SENSORS_REPLAY
	default "flight_logs/multimeter/2026-05-03/flight1/flights.csv"
	help
	  Path (relative to the aurora module root, i.e. the directory that
	  contains zephyr/module.yml) to the flights.csv file embedded by the
	  replay generator. May be overridden in prj.conf or via
	  -DCONFIG_AURORA_FAKE_SENSORS_REPLAY_INPUT=... to swap recordings.

menu "Inertial Measurement Unit (IMU)"

config IMU
	bool "Support for IMU"
	depends on AURORA_SENSORS
	default y if LSM6DSO
	help
		This option enables functionality for the Inertial Measurement
		Unit (IMU).

config IMU_TRIGGER
	bool "Support for IMU Trigger"
	depends on IMU
	default y if LSM6DSO_TRIGGER
	help
		This option enables functionality for the IMU
		to run triggers in an interrupt context.

# Only show frequency options when IMU is enabled
config IMU_FREQUENCY
	int "IMU update frequency (Hz)"
	depends on IMU
	default 100
	range 1 1000

choice IMU_UP_AXIS
	prompt "IMU body axis pointing up the rocket's long axis"
	depends on IMU || ATTITUDE
	default IMU_UP_AXIS_POS_Z
	help
	  Selects which IMU body-frame axis points toward the rocket's nose
	  when the rocket is vertical on the launch pad. Used to seed the
	  gravity vector for body-to-world projection of accelerometer data.

config IMU_UP_AXIS_POS_X
	bool "+X"
config IMU_UP_AXIS_NEG_X
	bool "-X"
config IMU_UP_AXIS_POS_Y
	bool "+Y"
config IMU_UP_AXIS_NEG_Y
	bool "-Y"
config IMU_UP_AXIS_POS_Z
	bool "+Z"
config IMU_UP_AXIS_NEG_Z
	bool "-Z"

endchoice

config IMU_UP_AXIS_INDEX
	int
	depends on IMU || ATTITUDE
	default 0 if IMU_UP_AXIS_POS_X || IMU_UP_AXIS_NEG_X
	default 1 if IMU_UP_AXIS_POS_Y || IMU_UP_AXIS_NEG_Y
	default 2 if IMU_UP_AXIS_POS_Z || IMU_UP_AXIS_NEG_Z

config IMU_UP_AXIS_SIGN
	int
	depends on IMU || ATTITUDE
	default 1  if IMU_UP_AXIS_POS_X || IMU_UP_AXIS_POS_Y || IMU_UP_AXIS_POS_Z
	default -1 if IMU_UP_AXIS_NEG_X || IMU_UP_AXIS_NEG_Y || IMU_UP_AXIS_NEG_Z

config IMU_CALIBRATION_SAMPLES
	int "IMU calibration samples"
	depends on IMU || ATTITUDE
	default 200
	range 10 10000
	help
	  Minimum number of IMU samples to average while the rocket is
	  stationary in SM_IDLE for accelerometer/gyroscope bias
	  estimation and gravity magnitude measurement, before the running
	  estimate is even checked for convergence. Calibration finishes
	  early once the estimate stops improving, or once a fixed multiple
	  of this many samples have been collected, whichever comes first
	  (see attitude_calibrate_converged()). At IMU_FREQUENCY Hz, this
	  floor is roughly IMU_CALIBRATION_SAMPLES / IMU_FREQUENCY seconds.

config IMU_CALIBRATION_RESTART_DEVIATION_DEG
	int "IMU calibration motion-restart threshold (deg)"
	depends on IMU || ATTITUDE
	default 5
	range 1 90
	help
	  Motion-sensitivity threshold for restarting an in-progress
	  calibration window, used three ways:
	    - Gyroscope: instantaneous magnitude threshold in degrees/second.
	    - Accelerometer: tilt-deviation threshold in degrees, measured
	      from the accelerometer direction recorded at the start of the
	      current window.
	    - Accelerometer: absolute tilt-deviation threshold in degrees,
	      measured from the configured mounting axis (CONFIG_IMU_UP_AXIS_*)
	      rather than the window's own start -- catches an attempt that
	      never held the correct orientation in the first place.
	  Exceeding any threshold while stationary in SM_IDLE discards the
	  in-progress calibration accumulator and restarts the window from
	  the next sample, so a bump or re-aim mid-window doesn't silently
	  corrupt the bias estimate. Tuned to tolerate ordinary pad sway/wind
	  without false-triggering while still catching a genuine bump.

config ATTITUDE
	bool "Attitude tracker (body-frame gravity vector)"
	default y if IMU
	help
	  Builds the gyro-integrated body-frame gravity tracker used to
	  project accelerometer readings onto world vertical.  Requires
	  CONFIG_IMU_UP_AXIS_* to be set.

endmenu

menu "Barometric Pressure Sensor (BARO)"

config BARO
	bool "Support for Baro"
	depends on AURORA_SENSORS
	default y if MS5607 || LPS22HH || BMP581
	help
		This option enables functionality for barometric pressure
		sensors.

config BARO_TRIGGER
	bool "Support for Baro Trigger"
	depends on BARO
	default y if LPS22HH_TRIGGER
	help
		This option enables functionality for barometric pressure
		sensors to run triggers in an interrupt context.

# Only show frequency options when BARO is enabled
config BARO_FREQUENCY
	int "BARO update frequency (Hz)"
	depends on BARO
	default 100
	range 1 1000

endmenu
```
