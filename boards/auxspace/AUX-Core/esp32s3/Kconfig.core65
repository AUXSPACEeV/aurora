## boards/auxspace/AUX-Core/esp32s3/Kconfig.core65
```kconfig
# Copyright (c) 2024 Espressif Systems (Shanghai) Co., Ltd.
# Copyright (c) 2026 Auxspace e.V.
# SPDX-License-Identifier: Apache-2.0

config BOARD_CORE65
	select SOC_ESP32S3
	select SOC_ESP32S3_PROCPU if BOARD_CORE65_ESP32S3_PROCPU
```

## boards/auxspace/AUX-Tel/stm32wl/Kconfig.sysbuild
```kconfig
# Copyright (c) 2026 Auxspace e.V.
# SPDX-License-Identifier: Apache-2.0

choice BOOTLOADER
	default BOOTLOADER_MCUBOOT
endchoice

choice MCUBOOT_MODE
	default MCUBOOT_MODE_SINGLE_APP
endchoice

choice BOOT_SIGNATURE_TYPE
	default BOOT_SIGNATURE_TYPE_ECDSA_P256
endchoice
```

## boards/auxspace/micrometer/esp32s3/Kconfig.micrometer
```kconfig
# Copyright (c) 2024 Espressif Systems (Shanghai) Co., Ltd.
# Copyright (c) 2026 Auxspace e.V.
# SPDX-License-Identifier: Apache-2.0

config BOARD_MICROMETER
	select SOC_ESP32S3
	select SOC_ESP32S3_PROCPU if BOARD_MICROMETER_ESP32S3_PROCPU
```

## lib/notify/Kconfig
```kconfig
# Copyright (c) 2026 Auxspace e.V.
# SPDX-License-Identifier: Apache-2.0

config AURORA_NOTIFY
	bool "Notification subsystem"
	help
	  Enable the notification subsystem.  When enabled, registered
	  backends (buzzer, RGB LED, ...) are called on boot, state-machine
	  transitions, and error conditions.

if AURORA_NOTIFY

module = AURORA_NOTIFY
module-str = AURORA_NOTIFY
source "subsys/logging/Kconfig.template.log_config"

DT_CHOSEN_AURORA_BUZZER := auxspace,buzzer

config AURORA_NOTIFY_BUZZER
	bool "Buzzer notifications"
	depends on $(dt_chosen_enabled,$(DT_CHOSEN_AURORA_BUZZER))
	select BUZZER
	select AURORA_PWM_MELODY
	help
	  Drive the buzzer behind the "auxspace,buzzer" chosen node (normally
	  a "pwm-buzzer" passive piezo) through Zephyr's buzzer API to signal
	  boot, state changes, and errors. Plays a melody when landed.

if AURORA_NOTIFY_BUZZER

config AURORA_NOTIFY_BUZZER_VOLUME
	int "Buzzer volume (percent)"
	default 100
	range 1 100
	help
	  Volume handed to buzzer_set_volume() at boot. For the "pwm-buzzer"
	  driver 100 % is a 50 % duty cycle, the loudest a piezo gets, so keep
	  the default for flight: it is the recovery beacon. Lower it to
	  spare your ears on the bench.

config AURORA_NOTIFY_BUZZER_QUEUE_SIZE
	int "Buzzer event queue depth"
	default 16
	range 1 128
	help
	  Maximum number of buzzer notification events that may be
	  queued before new events are dropped with a warning. Events
	  are played in FIFO order by a dedicated worker thread, so
	  ordering of sequences such as stop-melody-then-play-tone is
	  preserved.

config AURORA_NOTIFY_BUZZER_STACK_SIZE
	int "Buzzer worker thread stack size"
	default 1024
	help
	  Stack size (bytes) of the dedicated thread that plays queued
	  buzzer events.

config AURORA_NOTIFY_BUZZER_THREAD_PRIORITY
	int "Buzzer worker thread priority"
	default 10
	help
	  Zephyr priority of the buzzer worker thread. Lower numerical
	  values are higher priority; keep this numerically above
	  flight-critical threads (sensors, state machine — priority 5)
	  so notifications never preempt them.

endif # AURORA_NOTIFY_BUZZER

config AURORA_NOTIFY_LED
	bool "PWM LED notifications"
	depends on PWM
	depends on DT_HAS_PWM_LEDS_ENABLED
	help
	  Drive an LED via PWM to signal boot, state changes, and errors.

config AURORA_NOTIFY_DISK_LED
	bool "SD-card activity LED"
	depends on GPIO
	help
	  Drive the GPIO LED referenced by the "auxspace,disk-led" chosen
	  node as an SD-card activity indicator. Independent of the PWM
	  state-machine LED: it lights on disk writes and turns itself off
	  after a short idle window.

if AURORA_NOTIFY_DISK_LED

config AURORA_NOTIFY_DISK_LED_HOLD_MS
	int "SD activity LED hold time (ms)"
	default 40
	range 1 1000
	help
	  How long the SD activity LED stays lit after the most recent disk
	  access. Continuous writes keep it on; a pause longer than this
	  turns it off.

endif # AURORA_NOTIFY_DISK_LED

endif # AURORA_NOTIFY
```

## lib/pwm_melody/Kconfig
```kconfig
# Copyright (c) 2026 Auxspace e.V.
# SPDX-License-Identifier: Apache-2.0

config AURORA_PWM_MELODY
	bool "API for playing music on a buzzer"
	depends on BUZZER
	help
	  Enable the melody API. Melodies are played through Zephyr's
	  generic buzzer API, e.g. on a "pwm-buzzer" devicetree node.

if AURORA_PWM_MELODY

module = AURORA_PWM_MELODY
module-str = AURORA_PWM_MELODY
source "subsys/logging/Kconfig.template.log_config"

endif # AURORA_PWM_MELODY
```
