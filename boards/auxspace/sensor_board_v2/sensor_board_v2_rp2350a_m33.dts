/*
 * Copyright (c) 2025 Andrew Featherstone
 * Copyright (c) 2026 Auxspace e.V.
 *
 * SPDX-License-Identifier: Apache-2.0
 */

/dts-v1/;

#include <raspberrypi/rpi_pico/rp2350a.dtsi>
#include <raspberrypi/rpi_pico/m33.dtsi>
#include "sensor_board_v2_rp2350a-pinctrl.dtsi"
#include "sensor_board_v2_common.dtsi"
#include "sensor_board_v2_rp2350a.dtsi"
