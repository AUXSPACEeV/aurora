## Kconfig
```kconfig
# General configuration options

# Copyright (C) 2025 2025 Auxspace e.V.
# SPDX-License-Identifier: MIT

mainmenu "AURORA Project Configuration"

source "src/Kconfig"
```

## boards/auxspace/esp32s3_micrometer/Kconfig
```kconfig
# Copyright (c) 2024 Espressif Systems (Shanghai) Co., Ltd.
# Copyright (c) 2026 Auxspace e.V.
# SPDX-License-Identifier: Apache-2.0

config HEAP_MEM_POOL_ADD_SIZE_BOARD
	int
	default 4096 if BOARD_MICROMETER_ESP32S3_PROCPU
 
```

## boards/auxspace/esp32s3_micrometer/Kconfig.esp32s3_micrometer
```kconfig
# Copyright (c) 2024 Espressif Systems (Shanghai) Co., Ltd.
# Copyright (c) 2026 Auxspace e.V.
# SPDX-License-Identifier: Apache-2.0

config BOARD_ESP32S3_MICROMETER
	select SOC_ESP32S3_WROOM_N8
	select SOC_ESP32S3_PROCPU if BOARD_MICROMETER_ESP32S3_PROCPU
```

## boards/auxspace/esp32s3_micrometer/board.yml
```yaml
board:
  name: esp32s3_micrometer
  full_name: ESP32-S3-µMETER
  vendor: auxspaceev
  socs:
  - name: esp32s3
```

## boards/auxspace/esp32s3_micrometer/esp32s3_micrometer_procpu_defconfig
```kconfig
# SPDX-License-Identifier: Apache-2.0

CONFIG_CONSOLE=y
CONFIG_SERIAL=y
CONFIG_UART_CONSOLE=y
CONFIG_GPIO=y
CONFIG_CLOCK_CONTROL=y
CONFIG_MMC_STACK=y
CONFIG_USB_DEVICE_STACK_NEXT=y
```

## boards/auxspace/micrometer/esp32s3/board.yml
```yaml
board:
  name: micrometer
  full_name: µMETER
  vendor: auxspaceev
  revision:
    format: number
    default: "1"
    revisions:
    - name: "1"
    - name: "2"
  socs:
  - name: esp32s3
```

## boards/auxspace/sensor_board_v2/Kconfig
```kconfig
# Copyright (c) 2021 Yonatan Schachter
# Copyright (c) 2026 Auxspace e.V.
# SPDX-License-Identifier: Apache-2.0

config HEAP_MEM_POOL_ADD_SIZE_BOARD
	int
	default 4096
```

## boards/auxspace/sensor_board_v2/Kconfig.sensor_board_v2
```kconfig
# Copyright (c) 2021 Yonatan Schachter
# Copyright (c) 2024 Andrew Featherstone
# Copyright (c) 2026 Auxspace e.V.
# SPDX-License-Identifier: Apache-2.0

config BOARD_SENSOR_BOARD_V2
	select SOC_RP2040 if BOARD_SENSOR_BOARD_V2_RP2040
	select RP2_FLASH_W25Q080 if BOARD_SENSOR_BOARD_V2_RP2040
	select SOC_RP2350A_HAZARD3 if BOARD_SENSOR_BOARD_V2_RP2350A_HAZARD3
```

## boards/auxspace/sensor_board_v2/board.yml
```yaml
board:
  name: sensor_board_v2
  full_name: Sensor Board V2
  vendor: auxspaceev
  socs:
    - name: rp2040
      variants:
        - name: w
    - name: rp2350a
      variants:
        - name: w
          cpucluster: m33
```

## boards/auxspace/sensor_board_v2/sensor_board_v2_rp2040_w_defconfig
```kconfig
# Copyright (c) 2026 Auxspace e.V.
# SPDX-License-Identifier: Apache-2.0

CONFIG_BUILD_OUTPUT_HEX=y
CONFIG_BUILD_OUTPUT_UF2=y
CONFIG_CLOCK_CONTROL=y
CONFIG_CONSOLE=y
CONFIG_GPIO=y
CONFIG_MMC_STACK=y
CONFIG_RESET=y
CONFIG_SERIAL=y
CONFIG_UART_CONSOLE=y
CONFIG_USE_DT_CODE_PARTITION=y
CONFIG_USB_DEVICE_STACK_NEXT=y
```

## configs/sensor_board_defconfig
```kconfig
CONFIG_PICO_BOARD="pico"
CONFIG_LOG_LEVEL_DEBUG=y
CONFIG_LOG_TRACING=y
CONFIG_MMC=y
CONFIG_MMC_BROKEN_CD=y
CONFIG_SPI_MMC=y
```

## configs/test_defconfig
```kconfig
CONFIG_PICO_BOARD="pico"
CONFIG_LOG_LEVEL_DEBUG=y
CONFIG_LOG_TRACING=y
CONFIG_APP_NONE=y
```

## drivers/pyro/Kconfig
```kconfig
# Copyright (c) 2026 Auxspace e.V.
# SPDX-License-Identifier: Apache-2.0

menuconfig PYRO
	bool "Pyro drivers"
	default n
	help
	  Enable driver for pyro modules.

if PYRO

module = PYRO
module-str = pyro
source "subsys/logging/Kconfig.template.log_config"

config PYRO_INIT_PRIORITY
	int "Pyro init priority"
	default 80
	depends on PYRO

menu "Auxspace Pyro Drivers"
rsource "auxspaceev/Kconfig"
endmenu

endif # PYRO
```

## drivers/pyro/auxspaceev/Kconfig
```kconfig
# Copyright (c) 2026 Auxspace e.V.
# SPDX-License-Identifier: Apache-2.0

# zephyr-keep-sorted-start
rsource "basic_pyro/Kconfig"
# zephyr-keep-sorted-stop
```

## drivers/pyro/auxspaceev/basic_pyro/Kconfig
```kconfig
# Basic pyro module configuration options
#
# Copyright (c) 2026 Auxspace e.V.
# SPDX-License-Identifier: Apache-2.0

menuconfig BASIC_PYRO
	bool "Basic pyro module."
	default y
	depends on DT_HAS_AUXSPACEEV_BASIC_PYRO_ENABLED
	help
	  Enable driver for basic pyro module.
```

## drivers/pyro/auxspaceev/cap_pyro/Kconfig
```kconfig
# Capacitive pyro module configuration options
#
# Copyright (c) 2026 Auxspace e.V.
# SPDX-License-Identifier: Apache-2.0

menuconfig CAP_PYRO
	bool "Capacitive pyro module."
	default y
	depends on DT_HAS_AUXSPACEEV_CAP_PYRO_ENABLED
	help
	  Enable driver for the capacitive pyro module.
```

## drivers/pyro/auxspaceev/mini_pyro/Kconfig
```kconfig
# Mini pyro module configuration options
#
# Copyright (c) 2026 Auxspace e.V.
# SPDX-License-Identifier: Apache-2.0

menuconfig MINI_PYRO
	bool "Mini pyro module from the MicroMETER project."
	default y
	depends on DT_HAS_AUXSPACEEV_MINI_PYRO_ENABLED
	help
	  Enable driver for mini pyro module.
```

## drivers/recovery/Kconfig
```kconfig
# Copyright (c) 2026 Auxspace e.V.
# SPDX-License-Identifier: Apache-2.0

menuconfig RECOVERY
	bool "Recovery drivers"
	default n
	help
	  Enable recovery device drivers.

if RECOVERY

menu "Recovery Drivers"

rsource "auxspaceev/Kconfig"

endmenu

endif # RECOVERY
```

## drivers/recovery/auxspaceev/pyro/Kconfig
```kconfig
# Pyro module configuration options

# Copyright (c) 2026 Auxspace e.V.
# SPDX-License-Identifier: Apache-2.0

menuconfig PYRO
    prompt "Pyro drivers"
    default n
    help
      Enables support for Pyro recovery modules used in Auxspace recovery systems.

if PYRO

module = PYRO
module-str = pyro
source "subsys/logging/Kconfig.template.log_config"

menu "Pyro configuration"
rsource "pyro_config.Kconfig"
endmenu

endif
```

## dts/bindings/buzzer/auxspaceev,pwm-buzzer.yaml
```yaml
# PWM Buzzer
#
# Copyright (c) 2026 Auxspace e.V.
# SPDX-License-Identifier: Apache-2.0

title: PWM passive buzzer
description: A passive buzzer driven by a PWM channel.

compatible: "auxspaceev,pwm-buzzer"

properties:
  pwms:
    required: true
    type: phandle-array
    description: PWM specifier for the buzzer output.
```

## dts/bindings/flight-log-disk/auxspaceev,flight-log-disk.yaml
```yaml
# Flight log on a Zephyr disk-access block device
#
# Describes the byte region of a SD/MMC card (or any zephyr,...-disk
# device) that the binary data logger writes the live flight log into,
# bypassing the filesystem.  Selected via the chosen entry
# `auxspace,flight-log-disk`.
#
# The byte values are 64-bit, encoded as two 32-bit cells <HI LO>, so
# offsets and sizes greater than 4 GiB - 1 are representable.
#
# Example:
#
#   / {
#       chosen {
#           auxspace,flight-log-disk = &flight_log_disk;
#       };
#
#       flight_log_disk: flight-log-disk {
#           compatible = "auxspaceev,flight-log-disk";
#           disk-name = "MMC";
#           offset-bytes = <0x0 0x40000000>;  /* skip first 1 GiB */
#           size-bytes   = <0x0 0x10000000>;  /* 256 MiB region */
#       };
#   };
#
# When `size-bytes` is omitted, the region extends from `offset-bytes`
# to the end of the disk (queried at runtime).
#
# Copyright (c) 2026 Auxspace e.V.
# SPDX-License-Identifier: Apache-2.0

description: Raw-disk region for the binary flight log.

compatible: "auxspaceev,flight-log-disk"

properties:
  disk-name:
    type: string
    required: true
    description: |
      Zephyr disk-access name of the underlying block device (e.g. "MMC"
      for an SD card slot exposed as zephyr,sdmmc-disk).

  offset-bytes:
    type: array
    required: true
    description: |
      64-bit byte offset of the flight-log region from the start of the
      disk (zero-based), encoded as two 32-bit cells <HI LO>.  Allows
      the flight log to coexist with a filesystem that uses the rest of
      the card; the application is responsible for ensuring the
      filesystem does not overlap this range.  Must be a whole multiple
      of the disk's logical sector size (queried at runtime via
      DISK_IOCTL_GET_SECTOR_SIZE; 512 on every SD/MMC).

  size-bytes:
    type: array
    required: false
    description: |
      64-bit byte size of the region reserved for the flight log,
      encoded as two 32-bit cells <HI LO>.  Must be a whole multiple of
      the disk's logical sector size and of
      CONFIG_DATA_LOGGER_BIN_FRAME_SIZE.  When omitted, the region
      extends from `offset-bytes` to the end of the disk (sector count
      queried at runtime via DISK_IOCTL_GET_SECTOR_COUNT).
```
