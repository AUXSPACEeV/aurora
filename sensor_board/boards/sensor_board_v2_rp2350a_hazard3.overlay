/*
 * Copyright (c) 2026 Auxspace e.V.
 * SPDX-License-Identifier: Apache-2.0
 *
 * RP2350a sensor board overlay.  The flight log lives on a sector
 * range of the SD card (DATA_LOGGER_BIN_BACKEND_DISK), so internal
 * flash is reserved entirely for code.
 *
 * The flight-log region starts 1 GiB into the card and reserves
 * 256 MiB.  The FATFS volume mounted at /MMC: must be sized to the
 * first 1 GiB of the card so it does not overlap the raw region.
 */

#include "sensor_board_v2.dtsi"

&timer0 {
	status = "okay";
};

/ {
	chosen {
		auxspace,flight-log-disk = &flight_log_disk;
	};

	flight_log_disk: flight-log-disk {
		compatible = "auxspaceev,flight-log-disk";
		disk-name = "MMC";
		offset-bytes = <0x40000000>;	/* 1 GiB */
		size-bytes   = <0x10000000>;	/* 256 MiB */
	};
};
