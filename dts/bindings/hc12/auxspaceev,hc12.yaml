## lib/data/Kconfig
```kconfig
# Copyright (c) 2026 Auxspace e.V.
# SPDX-License-Identifier: Apache-2.0

config DATA_LOGGER
	bool "Generic telemetry data logger"
	depends on FILE_SYSTEM
	help
	  Enable the format-agnostic data logger for flight telemetry.
	  During flight (ARMED→LANDED), datapoints are appended to a
	  compact fixed-size binary file.  On transition to IDLE, LANDED
	  or ERROR the binary file is streamed through one or more
	  conversion targets (CSV, InfluxDB line protocol).

if DATA_LOGGER

module = DATA_LOGGER
module-str = data_logger
source "subsys/logging/Kconfig.template.log_config"

config DATA_LOGGER_BIN
	bool "Build fixed-size binary formatter (flight-time)"
	default y
	help
	  Build the binary formatter and the streaming converter.  Each
	  datapoint becomes a 40-byte little-endian record prefixed by a
	  16-byte file header.  Converted post-flight via
	  data_logger_convert().

if DATA_LOGGER_BIN

config DATA_LOGGER_BIN_BUF_SIZE
	int "Per-buffer size for binary log staging (bytes)"
	default 4096
	help
	  Size of each RAM staging buffer.  Records are accumulated in one
	  of CONFIG_DATA_LOGGER_BIN_BUF_COUNT buffers and flushed to the
	  underlying filesystem with a single fs_write() when the buffer
	  fills.  Pick a multiple of the block-driver sector size (512 B for
	  FAT, typically 4096 B for littlefs / NOR) so each fs_write lands
	  on a sector boundary.

config DATA_LOGGER_BIN_BUF_COUNT
	int "Number of binary log staging buffers"
	default 3
	range 2 8
	help
	  2 (double-buffer) is the minimum: producer fills one while the
	  writer drains the other.  3 (triple-buffer) gives one extra buffer
	  of slack to absorb SD-card erase pauses without backpressure on
	  the sensor pipeline.  More buffers cost more RAM with diminishing
	  returns.

config DATA_LOGGER_BIN_BUF_ALIGN
	int "Alignment of binary log staging buffers (bytes)"
	default 32
	help
	  Buffers are aligned to this many bytes so the underlying block
	  driver can DMA into them without bounce-buffering.  32 covers the
	  cache-line size of every supported MCU; bump it if your SD/NAND
	  driver requires a stricter alignment.

config DATA_LOGGER_BIN_WRITER_STACK_SIZE
	int "Binary log writer thread stack size (bytes)"
	default 1024

config DATA_LOGGER_BIN_WRITER_PRIO
	int "Binary log writer thread priority"
	default 10
	help
	  Should be a lower priority (higher number) than the upstream
	  logger thread that produces records, but high enough that the
	  filesystem is serviced promptly.

config DATA_LOGGER_BIN_PRODUCER_TIMEOUT_MS
	int "Max time the producer waits for a free staging buffer (ms)"
	default 50
	help
	  If every staging buffer is queued for the writer when a new
	  record arrives, the producer waits up to this many ms for the
	  writer to free one.  On timeout the rotation fails and upstream
	  records are dropped until the writer catches up.

config DATA_LOGGER_BIN_FLUSH_TIMEOUT_MS
	int "Max time bin_flush() waits for the writer to drain (ms)"
	default 2000

endif # DATA_LOGGER_BIN

config DATA_LOGGER_MOCK
	bool "Build mock formatter (test only)"
	help
	  Build against an externally provided mock formatter for unit
	  testing the core dispatch layer.  The symbol
	  data_logger_mock_formatter must be defined by the test
	  application.

config DATA_LOGGER_CONVERT_CSV
	bool "Enable CSV conversion target"
	default y
	help
	  Build the CSV formatter so data_logger_convert() can emit a
	  header-prefixed UTF-8 CSV file from a binary log.

config DATA_LOGGER_CONVERT_INFLUX
	bool "Enable InfluxDB Line Protocol conversion target"
	help
	  Build the InfluxDB line-protocol formatter so data_logger_convert()
	  can emit one InfluxDB line per datapoint from a binary log.

config DATA_LOGGER_BASE_PATH
	string "Output directory for data logger files"
	default "/data"
	help
	  Directory where the data logger writes output files.  The final
	  path is <base_path>/<filename>.<file_ext>, where filename is
	  passed to data_logger_init() and file_ext comes from the active
	  formatter backend.

config DATA_LOGGER_MAX_FILES
	int "Maximum number of log files in DATA_LOGGER_BASE_PATH"
	default 200
	help
	  Maximum number of files in the directory where the data logger writes
	  output files.
	  If the maximum is reached, old files are overwritten.

if DATA_LOGGER_CONVERT_INFLUX

config DATA_LOGGER_INFLUX_MEASUREMENT
	string "InfluxDB measurement name"
	default "telemetry"
	help
	  The measurement name embedded in every InfluxDB line protocol record.

config DATA_LOGGER_INFLUX_BUF_SIZE
	int "RAM write buffer size in bytes"
	default 4096
	help
	  Datapoints are accumulated in this RAM buffer and only written to
	  the filesystem on flush.  A larger buffer reduces the number of
	  fs_write/fs_sync calls (better for SD card longevity and power-fail
	  safety) but uses more RAM.  Data that has not been flushed is lost
	  on power failure.

endif # DATA_LOGGER_CONVERT_INFLUX

config DATA_LOGGER_MAX_LOGGERS
	int "Maximum number of data logger instances"
	default 4
	help
	  Upper bound on the number of data loggers that can be registered
	  simultaneously.  Each slot costs one pointer in a static array.

config DATA_LOGGER_SHELL
	bool "Data logger shell commands"
	depends on SHELL
	help
	  Enable shell commands for listing, starting, stopping, flushing,
	  and querying the status of registered data loggers.

endif # DATA_LOGGER
```

## lib/filter/Kconfig
```kconfig
# Copyright (c) 2026 Auxspace e.V.
# SPDX-License-Identifier: Apache-2.0

config FILTER
	bool "Support for input filtering"
	help
		This option enables filter algorithms for input values.

if FILTER

module = AURORA_FILTER
module-str = AURORA_FILTER
source "subsys/logging/Kconfig.template.log_config"

choice FILTER_TYPE
	bool "State machine filter technique"
	default FILTER_KALMAN

config FILTER_KALMAN
	bool "Kalman filter for apogee detection"
	help
		Use a kalman filter for apogee detection.

endchoice

config FILTER_Q_ALT_MILLISCALE
    int "Process noise altitude (x1000)"
    default 100
    range 0 100000
    help
      Process noise covariance for altitude state scaled by 1000.
      Increase if altitude estimate lags.
      Real value = FILTER_Q_ALT_MILLISCALE / 1000.0

config FILTER_Q_VEL_MILLISCALE
    int "Process noise velocity (x1000)"
    default 500
    range 0 100000
    help
      Process noise covariance for velocity state scaled by 1000.
      Increase for more aggressive response during boost.
      Real value = FILTER_Q_VEL_MILLISCALE / 1000.0

config FILTER_R_MILLISCALE
    int "Measurement noise variance (x1000)"
    default 4000       # 4.000
    range 1 1000000
    help
      Measurement noise variance scaled by 1000.
      Real value = FILTER_R_MILLISCALE / 1000.0

config FILTER_APOGEE_K_SIGMA_MILLI
    int "Apogee descent confirmation (x1000, sigma multiples)"
    default 4000
    range 0 100000
    help
      Filtered altitude must have descended at least
      k_sigma * sqrt(P[0][0]) below the tracked peak before apogee
      is reported, where P[0][0] is the KF's current altitude
      variance.  The threshold therefore scales with measurement
      noise and self-tunes: a noisy baro gets a wider gate, a clean
      one gets a tight gate, without a fixed meter tolerance.
      Real value = FILTER_APOGEE_K_SIGMA_MILLI / 1000.0.

config FILTER_APOGEE_DEBOUNCE_SAMPLES
    int "Apogee debounce samples"
    default 3
    range 1 100
    help
      Number of consecutive calls to filter_detect_apogee() for which
      all apogee criteria must hold before apogee is reported.
endif
```

## lib/notify/Kconfig
```kconfig
# Copyright (c) 2026 Auxspace e.V.
# SPDX-License-Identifier: Apache-2.0

config AURORA_NOTIFY
	bool "Notification subsystem"
	help
	  Enable the notification subsystem.  When enabled, registered
	  backends (buzzer, RGB LED, ...) are called on boot, state-machine
	  transitions, and error conditions.

if AURORA_NOTIFY

module = AURORA_NOTIFY
module-str = AURORA_NOTIFY
source "subsys/logging/Kconfig.template.log_config"

config AURORA_NOTIFY_BUZZER
	bool "PWM buzzer notifications"
	depends on PWM
	depends on DT_HAS_AUXSPACEEV_PWM_BUZZER_ENABLED
	select AURORA_PWM_MELODY
	help
	  Drive a passive buzzer via PWM to signal boot, state changes,
	  and errors. Plays a melody when landed.

if AURORA_NOTIFY_BUZZER

config AURORA_NOTIFY_BUZZER_QUEUE_SIZE
	int "Buzzer event queue depth"
	default 16
	range 1 128
	help
	  Maximum number of buzzer notification events that may be
	  queued before new events are dropped with a warning. Events
	  are played in FIFO order by a dedicated worker thread, so
	  ordering of sequences such as stop-melody-then-play-tone is
	  preserved.

config AURORA_NOTIFY_BUZZER_STACK_SIZE
	int "Buzzer worker thread stack size"
	default 1024
	help
	  Stack size (bytes) of the dedicated thread that plays queued
	  buzzer events.

config AURORA_NOTIFY_BUZZER_THREAD_PRIORITY
	int "Buzzer worker thread priority"
	default 10
	help
	  Zephyr priority of the buzzer worker thread. Lower numerical
	  values are higher priority; keep this numerically above
	  flight-critical threads (sensors, state machine — priority 5)
	  so notifications never preempt them.

endif # AURORA_NOTIFY_BUZZER

config AURORA_NOTIFY_LED
	bool "PWM LED notifications"
	depends on PWM
	depends on DT_HAS_PWM_LEDS_ENABLED
	help
	  Drive an LED via PWM to signal boot, state changes, and errors.

config AURORA_NOTIFY_DISK_LED
	bool "SD-card activity LED"
	depends on GPIO
	help
	  Drive the GPIO LED referenced by the "auxspace,disk-led" chosen
	  node as an SD-card activity indicator. Independent of the PWM
	  state-machine LED: it lights on disk writes and turns itself off
	  after a short idle window.

if AURORA_NOTIFY_DISK_LED

config AURORA_NOTIFY_DISK_LED_HOLD_MS
	int "SD activity LED hold time (ms)"
	default 40
	range 1 1000
	help
	  How long the SD activity LED stays lit after the most recent disk
	  access. Continuous writes keep it on; a pause longer than this
	  turns it off.

endif # AURORA_NOTIFY_DISK_LED

endif # AURORA_NOTIFY
```

## lib/pad_link/Kconfig
```kconfig
# Copyright (c) 2026 Auxspace e.V.
# SPDX-License-Identifier: Apache-2.0

config AURORA_PAD_LINK
	bool "BLE pad-link status server"
	select BT
	select BT_PERIPHERAL
	help
	  Expose a custom BLE GATT service so a pad-side central
	  (the launchrail) can fetch SM state, the last raw sensor
	  values, the last computed kinematic outputs, and a board
	  identifier while the rocket is on the pad. The link is
	  passive (central polls/subscribes), short-range, and not
	  intended as an in-flight downlink. Connection loss is a
	  non-event and advertising resumes automatically.

if AURORA_PAD_LINK

module = AURORA_PAD_LINK
module-str = AURORA_PAD_LINK
source "subsys/logging/Kconfig.template.log_config"

config AURORA_PAD_LINK_DEVICE_NAME
	string "Advertised BLE device name"
	default "AURORA-Rocket"

config AURORA_PAD_LINK_BOARD_ID
	string "Board identifier exposed over BLE"
	default "$(BOARD)"
	help
	  Reported via the read-only board-identifier characteristic
	  so the central can distinguish hardware revisions
	  (e.g. sensor_board_v2/rp2040).

endif # AURORA_PAD_LINK
```

## lib/pwm_melody/Kconfig
```kconfig
# Copyright (c) 2026 Auxspace e.V.
# SPDX-License-Identifier: Apache-2.0

config AURORA_PWM_MELODY
	bool "API for playing music with PWM devices"
	help
	  Enable the pwm melody api.

if AURORA_PWM_MELODY

module = AURORA_PWM_MELODY
module-str = AURORA_PWM_MELODY
source "subsys/logging/Kconfig.template.log_config"

endif # AURORA_NOTIFY
```

## sensor_board/boards/native_sim.conf
```kconfig
# native_sim target for data-path / filter / thread-priority testing.
# Real sensor drivers are replaced by the synthetic profile generator.

CONFIG_MAIN_STACK_SIZE=4096

# Console over stdout
CONFIG_UART_CONSOLE=y
CONFIG_UART_NATIVE_PTY_0_ON_STDINOUT=y
CONFIG_SHELL_STACK_SIZE=4096

# FAT filesystem on a RAM disk
CONFIG_DISK_DRIVERS=y
CONFIG_FILE_SYSTEM=y
CONFIG_FILE_SYSTEM_SHELL=y
CONFIG_FILE_SYSTEM_SHELL_TEST_COMMANDS=y
CONFIG_FILE_SYSTEM_MKFS=y
CONFIG_FAT_FILESYSTEM_ELM=y
CONFIG_FS_FATFS_LFN=y
CONFIG_FS_FATFS_FSTAB_AUTOMOUNT=y
# logging
CONFIG_LOG_MODE_DEFERRED=y
CONFIG_LOG_BACKEND_UART=n
CONFIG_SHELL_LOG_BACKEND=n
CONFIG_LOG_BACKEND_FS=y
CONFIG_LOG_BACKEND_FS_DIR="/RAM:/logs"
CONFIG_LOG_BACKEND_FS_FILES_LIMIT=512
CONFIG_LOG_PROCESS_THREAD_STACK_SIZE=4096
# Data logger
CONFIG_DATA_LOGGER=y
CONFIG_DATA_LOGGER_BIN_BACKEND_FLASH=y
CONFIG_DATA_LOGGER_CONVERT_INFLUX=y
CONFIG_DATA_LOGGER_CONVERT_CSV=y
CONFIG_DATA_LOGGER_BASE_PATH="/RAM:/data"
CONFIG_DATA_LOGGER_SHELL=y
# Live flight log on simulated raw flash (see native_sim.overlay).
CONFIG_FLASH_SIMULATOR=y
CONFIG_FLASH_SIMULATOR_STATS=n
# State machine audit
CONFIG_AURORA_STATE_MACHINE_AUDIT=y
CONFIG_AURORA_STATE_MACHINE_AUDIT_BASE_PATH="/RAM:/state"
# Filtering
CONFIG_FILTER=y
CONFIG_FILTER_Q_VEL_MILLISCALE=3000
CONFIG_FILTER_R_MILLISCALE=6000
CONFIG_FILTER_APOGEE_DEBOUNCE_SAMPLES=3

# Heap required by k_malloc in formatter backends
CONFIG_HEAP_MEM_POOL_SIZE=8192

# Aurora sensor HAL stays on so zbus channels and conversion helpers are built,
# but AURORA_FAKE_SENSORS replaces the hardware polling threads.
CONFIG_SENSOR=y
CONFIG_AURORA_SENSORS=y
CONFIG_IMU=y
CONFIG_IMU_UP_AXIS_POS_Y=y
CONFIG_IMU_FREQUENCY=1000
CONFIG_IMU_CALIBRATION_SAMPLES=100
CONFIG_BARO=y
CONFIG_BARO_FREQUENCY=1000
CONFIG_FILTER=y
CONFIG_FILTER_Q_VEL_MILLISCALE=3000
CONFIG_FILTER_R_MILLISCALE=6000
CONFIG_FILTER_APOGEE_DEBOUNCE_SAMPLES=3
CONFIG_AURORA_FAKE_SENSORS=y

# No pyro, no storage, no notifications, no powerfail on native_sim.

# Thresholds mirror the simulated short-flight profile.
CONFIG_BOOST_ACCELERATION=15
CONFIG_BOOST_ALTITUDE=5
CONFIG_BURNOUT_ACCELERATION=10
CONFIG_MAIN_DESCENT_HEIGHT=50
CONFIG_LANDING_VELOCITY=2
CONFIG_BOOST_TIMER_MS=200
CONFIG_APOGEE_TIMEOUT_MS=60000
CONFIG_MAIN_TIMEOUT_MS=2000
```

## sensor_board/boards/rpi_pico.conf
```kconfig
CONFIG_MAIN_STACK_SIZE=2048
CONFIG_CLOCK_CONTROL=y
CONFIG_USE_DT_CODE_PARTITION=y
CONFIG_BUILD_OUTPUT_HEX=y
CONFIG_GPIO=y
CONFIG_LOG=y
CONFIG_RESET=y
CONFIG_CONSOLE=y
CONFIG_AURORA_SENSORS=y
CONFIG_IMU=y
CONFIG_BARO=y
CONFIG_BARO_OS_4096X=y
CONFIG_AURORA_STATE_MACHINE=y
CONFIG_BOOT_BANNER_STRING="Booting AURORA"
CONFIG_UART_CONSOLE=y
CONFIG_SENSOR=y
CONFIG_LSM6DSO_ENABLE_TEMP=y
CONFIG_UART_LINE_CTRL=y
CONFIG_FILE_SYSTEM=y
CONFIG_FILE_SYSTEM_SHELL=y
CONFIG_FILE_SYSTEM_SHELL_TEST_COMMANDS=y
CONFIG_FILE_SYSTEM_MKFS=y
CONFIG_FAT_FILESYSTEM_ELM=y
CONFIG_FS_FATFS_EXFAT=y
CONFIG_FS_FATFS_LBA64=y
CONFIG_FS_FATFS_CUSTOM_MOUNT_POINT_COUNT=1
CONFIG_FS_FATFS_CUSTOM_MOUNT_POINTS="MMC"
CONFIG_FS_FATFS_FSTAB_AUTOMOUNT=y
CONFIG_LOG_DEFAULT_LEVEL=2
CONFIG_LOG_TIMESTAMP_USE_REALTIME=y
CONFIG_LOG_SPEED=y
CONFIG_LOG_THREAD_ID_PREFIX=y
CONFIG_LOG_INFO_COLOR_GREEN=y
CONFIG_LOG_DBG_COLOR_BLUE=y
CONFIG_LOG_OUTPUT_FORMAT_TIME_TIMESTAMP=y
CONFIG_LOG_BACKEND_FS=y
# CONFIG_LOG_BACKEND_FS_APPEND_TO_NEWEST_FILE is not set
CONFIG_LOG_BACKEND_FS_DIR="/MMC:/logs"
CONFIG_LOG_BACKEND_FS_FILES_LIMIT=512
CONFIG_LOG_BACKEND_UART=y
CONFIG_LOG_CMDS=y
# CONFIG_LOG_MEM_UTILIZATION is not set
CONFIG_MMC_STACK=y
CONFIG_SHELL=y
CONFIG_USB_DEVICE_STACK_NEXT=y
CONFIG_USBD_CDC_ACM_LOG_LEVEL_OFF=y
CONFIG_CDC_ACM_SERIAL_INITIALIZE_AT_BOOT=y
CONFIG_BUILD_OUTPUT_UF2=y
CONFIG_USB_CONSOLE_SHELL=y
```
