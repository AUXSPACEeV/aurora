## dts/bindings/hc12/auxspaceev,hc12.yaml
```yaml
# HC-12 433 MHz transparent UART-RF transceiver
#
# The HC-12 sits on a host UART and acts as a transparent serial bridge
# to a peer HC-12 over the 433 MHz ISM band. Channel, air baud, TX power
# and FU mode persist in the module's own flash and are configured by
# pulling the SET pin low, sending AT commands at 9600 baud, and
# releasing SET.
#
# Example:
#
#   / {
#       chosen {
#           auxspace,telemetry-hc12 = &hc12;
#       };
#
#       hc12: hc12 {
#           compatible = "auxspaceev,hc12";
#           uart = <&uart1>;
#           set-gpios = <&gpio0 6 GPIO_ACTIVE_LOW>;
#           status = "okay";
#       };
#   };
#
#   &uart1 {
#       current-speed = <9600>;
#       pinctrl-0 = <&uart1_default>;
#       pinctrl-names = "default";
#       status = "okay";
#   };
#
#   &gpio0 {
#       status = "okay";
#   }
#
# Copyright (c) 2026 Auxspace e.V.
# SPDX-License-Identifier: Apache-2.0

description: HC-12 433 MHz transparent UART-RF transceiver

compatible: "auxspaceev,hc12"

include: base.yaml

properties:
  uart:
    type: phandle
    required: true
    description: |
      UART peripheral the HC-12 is wired to. The host UART
      `current-speed` should match the module's configured air-side
      baud rate during normal (transparent) operation. While the
      module is in AT-command mode (SET pulled low) it always uses
      9600 baud regardless of the configured rate.

  set-gpios:
    type: phandle-array
    required: false
    description: |
      Optional. GPIO line wired to the HC-12 SET pin. When provided,
      firmware can enter AT-command mode at runtime (e.g. via the
      telemetry shell) to read or update channel, baud, TX power and
      FU mode. When omitted, the module is treated as
      bench-provisioned and runtime reconfiguration is unavailable.
      Active-low (the HC-12 enters AT mode while SET is held low).
```

## dts/bindings/led/auxspaceev,pwm-led.yaml
```yaml
# PWM LED
#
# Copyright (c) 2026 Auxspace e.V.
# SPDX-License-Identifier: Apache-2.0

title: PWM LED
description: An LED driven by a PWM channel.

compatible: "auxspaceev,pwm-led"

properties:
  pwms:
    required: true
    type: phandle-array
    description: PWM specifier for the LED output.
```

## dts/bindings/pyro/auxspaceev,basic-pyro.yaml
```yaml
# Basic Pyro Module
#
# Copyright (c) 2026 Auxspace e.V.
# SPDX-License-Identifier: Apache-2.0

title: Basic pyro module
description: Auxspace e.V. basic pyro module

compatible: "auxspaceev,basic-pyro"

include: pyro-device.yaml
```

## dts/bindings/pyro/auxspaceev,cap-pyro.yaml
```yaml
# Capacitive Pyro Module
#
# Copyright (c) 2026 Auxspace e.V.
# SPDX-License-Identifier: Apache-2.0

title: Capacitive pyro module
description: Auxspace e.V. capacitive pyro module

compatible: "auxspaceev,cap-pyro"

include: pyro-device.yaml
```

## dts/bindings/pyro/auxspaceev,gpio-pyro.yaml
```yaml
# Copyright (c) 2026 Auxspace e.V.
# SPDX-License-Identifier: Apache-2.0

description: GPIO-activated Pyro channel.

compatible: "auxspaceev,gpio-pyro"

include: "auxspaceev,pyro-common.yaml"

properties:
  trigger-gpios:
    type: phandle-array
    description: |
      An array of trigger GPIOs to use. Each element
      in the array specifies a GPIO.
      All trigger GPIOs are iterated and asserted when
      state machine goes into apogee state.

  redundand-gpios:
    type: phandle-array
    description: |
      An array of redundand GPIOs to use. Each element
      in the array specifies a GPIO.
      All redundand GPIOs are iterated and asserted
      when state machine goes into secondary fire
      state.

  arm-gpios:
    type: phandle-array
    description: |
      An array of ARM GPIOs to use. Each element
      in the array specifies a GPIO.
      All ARM GPIOs are iterated and asserted when
      state machine goes into armed state.
```

## dts/bindings/pyro/auxspaceev,i2c-pyro.yaml
```yaml
# Copyright (c) 2026 Auxspace e.V.
# SPDX-License-Identifier: Apache-2.0

description: I2C-activated Pyro channel.

compatible: "auxspaceev,i2c-pyro"

include: ["i2c-device.yaml", "auxspaceev,pyro-common.yaml"]
```

## dts/bindings/pyro/auxspaceev,mini-pyro.yaml
```yaml
# MicroMETER Pyro Module
#
# Copyright (c) 2026 Auxspace e.V.
# SPDX-License-Identifier: Apache-2.0

description: Auxspace e.V. MicroMETER mini pyro module

compatible: "auxspaceev,mini-pyro"

include: pyro-device.yaml
```

## dts/bindings/pyro/auxspaceev,pyro-common.yaml
```yaml
# Copyright (c) 2026 Auxspace e.V.
# SPDX-License-Identifier: Apache-2.0

description: Common device helper for auxspaceev pyros.

include: base.yaml

properties:
  "#triggers":
    type: int
    default: 0x1
    description: |
      Number of pyro triggers. This property specifies how many
      triggers this pyro element can handle.
```

## dts/bindings/pyro/pyro-device.yaml
```yaml
# Copyright (c) 2026 Auxspace e.V.
# SPDX-License-Identifier: Apache-2.0

description: Common device helper for pyros.

include: base.yaml

properties:
  trigger-gpios:
    type: phandle-array
    required: true
    description: |
      An array of trigger GPIOs to use. Each element
      in the array specifies a GPIO.

  arm-gpios:
    type: phandle-array
    required: true
    description: |
      An array of ARM GPIOs to use. Each element
      in the array specifies a GPIO.
      Usually, every channel can be armed on its
      own, but on smaller hardware, a single arm
      gpio is used to arm all trigger-gpios.
      The number of arm-gpios can either be the
      same as trigger-gpios or 1.

  short-gpios:
    type: phandle-array
    description: |
      An array of short GPIOs to use. Each element
      in the array specifies a GPIO.

  cap-gpios:
    type: phandle-array
    description: |
      An array of GPIOs that charge the pyro capacitor.
      Each element in the array specifies a GPIO.

  adcs:
    type: phandle-array
    description: |
      An array of ADCs to read a pyro channel's value.
      If sense-adcs are defined, every entry in the
      array corresponds to an entry in trigger-gpios.
```

## dts/bindings/recovery/auxspaceev,pyro.yaml
```yaml
# Pyro Module
#
# Copyright (c) 2026 Auxspace e.V.
# SPDX-License-Identifier: Apache-2.0

title: pyro module
description: Auxspace e.V. pyro module

compatible: "auxspaceev,pyro"

include: recovery-device.yaml
```

## dts/bindings/recovery/recovery-device.yaml
```yaml
# Copyright (c) 2026 Auxspace e.V.
# SPDX-License-Identifier: Apache-2.0

description: Common device helper for pyros.

include: base.yaml

properties:
  trigger-gpios:
    type: phandle-array
    required: true
    description: |
      An array of trigger GPIOs to use. Each element
      in the array specifies a GPIO.

  arm-gpios:
    type: phandle-array
    required: true
    description: |
      An array of ARM GPIOs to use. Each element
      in the array specifies a GPIO.
      Usually, every channel can be armed on its
      own, but on smaller hardware, a single arm
      gpio is used to arm all trigger-gpios.
      The number of arm-gpios can either be the
      same as trigger-gpios or 1.

  short-gpios:
    type: phandle-array
    description: |
      An array of short GPIOs to use. If short-gpios
      are defined, every entry in the array corresponds
      to an entry in trigger-gpios.

  cap-gpios:
    type: phandle-array
    description: |
      An array of GPIOs that charge the pyro capacitor.
      If cap-gpios are defined, every entry in the
      array corresponds to an entry in trigger-gpios.

  capv-adcs:
    type: phandle-array
    specifier-space: io-channel
    description: |
      An array of ADCs to get the charge of a capacitor
      of a pyro channel.
      If capv-adcs are defined, every entry in the
      array corresponds to an entry in trigger-gpios.

  capv-max:
    type: array
    description: |
      An array of voltages that define the max charge
      that is set to be on capv-adcs.
      A single voltage means, every adc in capv-adcs
      awaits the same target level.

  sense-adcs:
    type: phandle-array
    specifier-space: io-channel
    description: |
      An array of ADCs to get a pyro channel's health.
      If sense-adcs are defined, every entry in the
      array corresponds to an entry in trigger-gpios.

  sense-max:
    type: array
    description: |
      An array of voltages that define the max voltage
      to be awaited on sense-adcs.
      A single voltage means, every adc in sense-adcs
      awaits the same target level.
```

## lib/Kconfig
```kconfig
# Copyright (c) 2025-2026 Auxspace e.V.
# SPDX-License-Identifier: Apache-2.0

menu "Aurora libraries"

menu "Aurora Sensors"
rsource "sensor/Kconfig"
endmenu

menu "Input Filtering"
rsource "filter/Kconfig"
endmenu

menu "Data Storing"
rsource "data/Kconfig"
endmenu

menu "Notifications"
rsource "notify/Kconfig"
endmenu

menu "Powerfail"
rsource "powerfail/Kconfig"
endmenu

menu "PWM Melody"
rsource "pwm_melody/Kconfig"
endmenu

menu "State Machine"
rsource "state/Kconfig"
endmenu

endmenu
```

## lib/apogee/Kconfig
```kconfig
# Copyright (c) 2026 Auxspace e.V.
# SPDX-License-Identifier: Apache-2.0

module = AURORA_APOGEE_DETECTION
module-str = AURORA_APOGEE_DETECTION
source "subsys/logging/Kconfig.template.log_config"

menu "Apogee Detection"

config APOGEE_DETECTION
	bool "Support for apogee detection"
	help
		This option enables apogee detection algorithms.

if APOGEE_DETECTION

module = APOGEE_DETECTION
module-str = APOGEE_DETECTION
source "subsys/logging/Kconfig.template.log_config"

choice APOGEE_FILTER
	bool "Apogee filter technique"
	default FILTER_KALMAN

config FILTER_KALMAN
	bool "Kalman filter for apogee detection"
	help
		Use a kalman filter for apogee detection.

endchoice

config FILTER_Q_ALT_MILLISCALE
    int "Process noise altitude (x1000)"
    default 100
    range 0 100000
    help
      Process noise covariance for altitude state scaled by 1000.
      Increase if altitude estimate lags.
      Real value = FILTER_Q_ALT_MILLISCALE / 1000.0

config FILTER_Q_VEL_MILLISCALE
    int "Process noise velocity (x1000)"
    default 500
    range 0 100000
    help
      Process noise covariance for velocity state scaled by 1000.
      Increase for more aggressive response during boost.
      Real value = FILTER_Q_VEL_MILLISCALE / 1000.0

config FILTER_R_MILLISCALE
    int "Measurement noise variance (x1000)"
    default 4000       # 4.000
    range 1 1000000
    help
      Measurement noise variance scaled by 1000.
      Real value = FILTER_R_MILLISCALE / 1000.0
endif

endmenu
```

## lib/console/Kconfig
```kconfig
# Copyright (c) 2025 Auxspace e.V.
# SPDX-License-Identifier: Apache-2.0

module = USB_SERIAL
module-str = USB_SERIAL
source "subsys/logging/Kconfig.template.log_config"

config USB_SERIAL
	bool "Support for USB serial console"
	help
		This option enables functionality for a serial console via USB.
```
