## sensor_board/boards/rpi_pico_rp2040_w.conf
```kconfig
# Copyright (c) 2026 Auxspace e.V.
# SPDX-License-Identifier: Apache-2.0
#
# Bench config for the Raspberry Pi Pico / Pico W (RP2040). Pairs with
# -S sim -S nodisk, e.g.:
#   west build -b rpi_pico/rp2040/w -S sim -S nodisk aurora/sensor_board
#
# The matching .overlay puts the console on USB CDC and wires an HC-12
# to uart1 (TX=GP4, RX=GP5, SET=GP6). The Kconfig body below is the
# same as the Pico 2 W bench conf - keep them in sync when editing.

CONFIG_MAIN_STACK_SIZE=2048
CONFIG_GPIO=y
CONFIG_SERIAL=y
CONFIG_UART_CONSOLE=y
CONFIG_UART_LINE_CTRL=y
CONFIG_USB_DEVICE_STACK_NEXT=y
CONFIG_USBD_CDC_ACM_LOG_LEVEL_OFF=y
CONFIG_CDC_ACM_SERIAL_INITIALIZE_AT_BOOT=y
CONFIG_CBPRINTF_FP_SUPPORT=y

CONFIG_LOG_BACKEND_UART=y
CONFIG_LOG_BACKEND_UART_BUFFER_SIZE=32

CONFIG_AURORA_SENSORS=y
CONFIG_IMU=y
CONFIG_IMU_FREQUENCY=100
CONFIG_BARO=y
CONFIG_BARO_FREQUENCY=100
CONFIG_FILTER=y

CONFIG_AURORA_TELEMETRY=y
CONFIG_AURORA_TELEMETRY_HC12_MIN_INTERVAL_MS=100
CONFIG_AURORA_TELEMETRY_HC12_SHELL=y

CONFIG_LOG_BACKEND_UART=y
CONFIG_LOG_BACKEND_UART_BUFFER_SIZE=32
```

## sensor_board/boards/sensor_board_v2_rp2350a_hazard3.conf
```kconfig
CONFIG_USE_DT_CODE_PARTITION=y
CONFIG_MAIN_STACK_SIZE=2048
CONFIG_CLOCK_CONTROL=y
CONFIG_BUILD_OUTPUT_HEX=y
CONFIG_GPIO=y
CONFIG_RESET=y
CONFIG_AURORA_SENSORS=y
CONFIG_IMU=y
CONFIG_IMU_FREQUENCY=100
CONFIG_BARO=y
CONFIG_BARO_FREQUENCY=100
CONFIG_FILTER=y
CONFIG_UART_CONSOLE=y
CONFIG_SENSOR=y
CONFIG_LSM6DSO_ENABLE_TEMP=y
CONFIG_UART_LINE_CTRL=y
CONFIG_FILE_SYSTEM=y
CONFIG_FILE_SYSTEM_SHELL=y
CONFIG_FILE_SYSTEM_SHELL_TEST_COMMANDS=y
CONFIG_FILE_SYSTEM_MKFS=y
CONFIG_FAT_FILESYSTEM_ELM=y
CONFIG_FS_FATFS_EXFAT=y
CONFIG_FS_FATFS_LBA64=y
CONFIG_FS_FATFS_CUSTOM_MOUNT_POINT_COUNT=1
CONFIG_FS_FATFS_CUSTOM_MOUNT_POINTS="MMC"
CONFIG_LOG_BACKEND_FS=y
CONFIG_LOG_BACKEND_FS_DIR="/MMC:/logs"
CONFIG_LOG_BACKEND_FS_FILES_LIMIT=512
CONFIG_LOG_BACKEND_FS_FILE_SIZE=100000000
CONFIG_LOG_BACKEND_UART=y
CONFIG_LOG_BACKEND_UART_BUFFER_SIZE=32
CONFIG_DATA_LOGGER=y
CONFIG_DATA_LOGGER_BIN_BACKEND_DISK=y
CONFIG_DATA_LOGGER_CONVERT_INFLUX=y
CONFIG_DATA_LOGGER_BASE_PATH="/MMC:/data"
CONFIG_DATA_LOGGER_SHELL=y
CONFIG_MMC_STACK=y
CONFIG_AURORA_STATE_MACHINE_AUDIT=y
CONFIG_AURORA_STATE_MACHINE_AUDIT_BASE_PATH="/MMC:/state"
CONFIG_USB_DEVICE_STACK_NEXT=y
CONFIG_USBD_CDC_ACM_LOG_LEVEL_OFF=y
CONFIG_CDC_ACM_SERIAL_INITIALIZE_AT_BOOT=y
CONFIG_BUILD_OUTPUT_UF2=y
```

## src/Kconfig
```kconfig
# General configuration options

# Copyright (C) 2025 2025 Auxspace e.V.
# SPDX-License-Identifier: MIT

config PICO_BOARD
    string "pico board"
    help
        Board to select from the pico SDK and FreeRTOS

source "src/apps/Kconfig"
source "src/drivers/Kconfig"
source "src/tasks/Kconfig"
```
