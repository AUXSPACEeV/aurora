## src/apps/Kconfig
```kconfig
# App configuration options

# Copyright (C) 2025 2025 Auxspace e.V.
# SPDX-License-Identifier: MIT

choice APPLICATION
    bool "Aurora Application"
    default SENSOR_BOARD

config SENSOR_BOARD
    bool "Sensor Board"
    help
        Aurora sensor board application, featuring telemetry and other
        sensor-board-specific features.

config APP_NONE
    bool "NONE"

endchoice
```

## src/common/Kconfig
```kconfig
# Common configuration options

# Copyright (C) 2025 2025 Auxspace e.V.
# SPDX-License-Identifier: MIT

menu "logging"

config LOG_LEVEL_DEBUG
    bool "enable debug logging"
    help
        Enable debug logging

config LOG_TRACING
    bool "enable debug tracing"
    help
        Enable trace logs

endmenu
```

## src/drivers/Kconfig
```kconfig
# Driver configuration options

# Copyright (C) 2025 2025 Auxspace e.V.
# SPDX-License-Identifier: MIT

menu "drivers"

config MMC
	bool "MMC/SD/SDIO card support"
	default ARM || PPC || SANDBOX
	select BLK
	select DM_MMC
	help
	  This selects MultiMediaCard, Secure Digital and Secure
	  Digital I/O support.

	  If you want MMC/SD/SDIO support, you should say Y here and
	  also to your specific host controller driver.

source "src/drivers/mmc/Kconfig"

endmenu
```

## src/drivers/mmc/Kconfig
```kconfig
# MMC configuration options

# Copyright (C) 2025 2025 Auxspace e.V.
# SPDX-License-Identifier: MIT

menu "mmc"

config MMC_WRITE
	bool "support for MMC/SD write operations"
	depends on MMC
	default y
	help
	  Enable write access to MMC and SD Cards

config MMC_IO_VOLTAGE
	bool "Support IO voltage configuration"
	help
	  IO voltage configuration allows selecting the voltage level of the IO
	  lines (not the level of main supply). This is required for UHS
	  support. For eMMC this not mandatory, but not enabling this option may
	  prevent the driver of using the faster modes.

config MMC_SUPPORTS_TUNING
	bool

config MMC_UHS_SUPPORT
	bool "enable UHS support"
	depends on MMC_IO_VOLTAGE
	select MMC_SUPPORTS_TUNING
	help
	  The Ultra High Speed (UHS) bus is available on some SDHC and SDXC
	  cards. The IO voltage must be switchable from 3.3v to 1.8v. The bus
	  frequency can go up to 208MHz (SDR104)

config MMC_HS400_ES_SUPPORT
	bool "enable HS400 Enhanced Strobe support"
	help
	  The HS400 Enhanced Strobe mode is support by some eMMC. The bus
	  frequency is up to 200MHz. This mode does not tune the IO.

config MMC_HS400_SUPPORT
	bool "enable HS400 support"
	select MMC_HS200_SUPPORT
	help
	  The HS400 mode is support by some eMMC. The bus frequency is up to
	  200MHz. This mode requires tuning the IO.

config MMC_HS200_SUPPORT
	bool "enable HS200 support"
	select MMC_SUPPORTS_TUNING
	help
	  The HS200 mode is support by some eMMC. The bus frequency is up to
	  200MHz. This mode requires tuning the IO.

config MMC_QUIRKS
	bool "Enable quirks"
	default y
	help
	  Some cards and hosts may sometimes behave unexpectedly (quirks).
	  This option enable workarounds to handle those quirks. Some of them
	  are enabled by default, other may require additional flags or are
	  enabled by the host driver.

config MMC_BROKEN_CD
	bool "Poll for broken card detection case"
	help
	  If card  detection feature is broken, just poll to detect.

config SPI_MMC
    bool "Aurora SPI driver for MMC"
    depends on MMC
    help
        Enable the Aurora SPI driver for MMC devices

config MMC_SPI_CRC_ON
    bool "MMC SPI CRC"
    depends on MMC
    help
        Enable CRC checks for MMC devices

endmenu
```

## src/tasks/Kconfig
```kconfig
# Task configuration options

# Copyright (C) 2025 2025 Auxspace e.V.
# SPDX-License-Identifier: MIT

menu "tasks"

config WDT_CNTR_MS
    int "Watchdog timeout (ms)"
    default 5000
    help
        Watchdog timeout in milliseconds.

endmenu
```

## tests/lib/apogee/testcase.yaml
```yaml
tests:
  aurora.lib.apogee.kalman:
    integration_platforms:
      - qemu_x86
    platform_allow:
      - qemu_x86
    tags: test_apogee_detection
    extra_configs:
      - CONFIG_FILTER_KALMAN=y
```

## tests/lib/attitude/testcase.yaml
```yaml
tests:
  aurora.lib.attitude:
    integration_platforms:
      - qemu_x86
    platform_allow:
      - qemu_x86
    tags: test_attitude
    extra_configs:
      - CONFIG_ATTITUDE=y
```

## tests/lib/data/testcase.yaml
```yaml
common:
  modules:
    - fatfs

tests:
  aurora.lib.data.core:
    integration_platforms:
      - qemu_x86
    platform_allow:
      - qemu_x86
    tags: test_data_logger
    extra_configs:
      - CONFIG_DATA_LOGGER_BIN=n
      - CONFIG_DATA_LOGGER_MOCK=y
      - CONFIG_DATA_LOGGER_BASE_PATH="/RAM:/test"

  aurora.lib.data.csv:
    integration_platforms:
      - qemu_x86
    platform_allow:
      - qemu_x86
    tags: test_data_logger
    extra_configs:
      - CONFIG_DATA_LOGGER_CONVERT_CSV=y
      - CONFIG_DATA_LOGGER_BASE_PATH="/RAM:/test"
      - CONFIG_DATA_LOGGER_CSV_WINDOW_NS=10000000

  aurora.lib.data.influx:
    integration_platforms:
      - qemu_x86
    platform_allow:
      - qemu_x86
    tags: test_data_logger
    extra_configs:
      - CONFIG_DATA_LOGGER_CONVERT_INFLUX=y
      - CONFIG_DATA_LOGGER_BASE_PATH="/RAM:/test"

  aurora.lib.data.convert:
    integration_platforms:
      - qemu_x86
    platform_allow:
      - qemu_x86
    tags: test_data_logger
    extra_configs:
      - CONFIG_DATA_LOGGER_BIN=y
      - CONFIG_DATA_LOGGER_CONVERT_CSV=y
      - CONFIG_DATA_LOGGER_CONVERT_INFLUX=y
      - CONFIG_DATA_LOGGER_BASE_PATH="/RAM:/test"

  aurora.lib.data.flash:
    integration_platforms:
      - qemu_x86
    platform_allow:
      - qemu_x86
    tags: test_data_logger
    extra_configs:
      - CONFIG_DATA_LOGGER_BIN=y
      - CONFIG_DATA_LOGGER_BIN_BACKEND_FLASH=y
      - CONFIG_DATA_LOGGER_BASE_PATH="/RAM:/test"
```

## tests/lib/data_disk_auto_mkfs/testcase.yaml
```yaml
common:
  modules:
    - fatfs
  tags: test_data_logger
  integration_platforms:
    - native_sim
  platform_allow:
    - native_sim

tests:
  aurora.lib.data.disk_auto_mkfs: {}
```

## tests/lib/filter/testcase.yaml
```yaml
tests:
  aurora.lib.filter.kalman:
    integration_platforms:
      - qemu_x86
    platform_allow:
      - qemu_x86
    tags: test_kalman_filter
    extra_configs:
      - CONFIG_FILTER_KALMAN=y
```

## tests/lib/pad_link/testcase.yaml
```yaml
tests:
  aurora.lib.pad_link:
    integration_platforms:
      - native_sim/native/64
    platform_allow:
      - native_sim/native/64
    tags: test_pad_link
```

## tests/lib/state/testcase.yaml
```yaml
tests:
  aurora.lib.state:
    integration_platforms:
      - qemu_x86
    platform_allow:
      - qemu_x86
    tags: test_state_machine
```
