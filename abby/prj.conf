## CMakeLists.txt
```
#-------------------------------------------------------------------------------
# abby - AUX-Tel telemetry relay
#
# Copyright (c) 2026 Auxspace e.V.
# SPDX-License-Identifier: Apache-2.0

cmake_minimum_required(VERSION 3.20.0)

find_package(Zephyr REQUIRED HINTS $ENV{ZEPHYR_BASE})

project(abby LANGUAGES C)

target_sources(app PRIVATE
	src/main.c
	src/link.c
	src/downlink.c
	)

target_sources_ifdef(CONFIG_ABBY_SHELL app PRIVATE
	src/abby_shell.c
	)
```

## Kconfig
```
# Copyright (c) 2026 Auxspace e.V.
# SPDX-License-Identifier: Apache-2.0
#
# Application Kconfig entry point for abby, the AUX-Tel telemetry relay.

menu "Zephyr"

source "Kconfig.zephyr"

endmenu

module = ABBY
module-str = ABBY
source "subsys/logging/Kconfig.template.log_config"

menu "abby - AUX-Tel telemetry relay"

choice ABBY_ROLE
	prompt "Role"
	default ABBY_ROLE_RELAY
	help
	  Which end of the LoRa link this firmware is. The two roles are
	  mirror images and share the radio settings below, which is the
	  point: a LoRa link only decodes when both ends agree on frequency,
	  spreading factor and bandwidth, so building both ends from one
	  application keeps them in step instead of leaving it to two
	  separate sets of constants.

config ABBY_ROLE_RELAY
	bool "Relay (vehicle): stack UART in, LoRa out"
	help
	  The flight role. Telemetry frames arrive from a brain board over
	  the AUX-Stack data connector and every frame that passes its CRC
	  is relayed verbatim over LoRa.

config ABBY_ROLE_RECEIVE
	bool "Receive (ground): LoRa in, stack UART out"
	help
	  The ground role. Frames arrive over LoRa and every one that
	  validates is written verbatim to the AUX-Stack data connector's
	  UART, so whatever is attached there - a brain board, or a
	  USB-serial adapter - sees exactly the byte stream a directly wired
	  relay would have produced.

endchoice

menu "LoRa downlink"

config ABBY_LORA_FREQ_HZ
	int "Carrier frequency (Hz)"
	default 868100000
	help
	  Must sit in the module's band (Daphnis-I: 863..870 MHz) and on a
	  channel your regulator permits. The Daphnis-I user manual's
	  channel assignment table lists the EN 300 220 limits per channel,
	  including which ones allow more than a 1 % duty cycle - worth
	  consulting before raising ABBY_DUTY_CYCLE_PERMILLE.

config ABBY_LORA_SF
	int "Spreading factor"
	range 5 12
	default 7
	help
	  Higher spreads reach further and cost airtime roughly doubling per
	  step, which the duty-cycle budget then charges for. SF7 keeps a
	  70-byte frame near 130 ms; SF12 pushes the same frame past three
	  seconds.

config ABBY_LORA_BW_KHZ
	int "Signal bandwidth (kHz)"
	default 125
	help
	  Values map onto enum lora_signal_bandwidth: 7, 10, 15, 20, 31, 41,
	  62, 125, 200, 250, 400, 500, 800 or 1000.

config ABBY_LORA_CODING_RATE
	int "Coding rate denominator offset (1 = 4/5 ... 4 = 4/8)"
	range 1 4
	default 1
	help
	  Values map onto enum lora_coding_rate: 1 is CR_4_5, 4 is CR_4_8.

config ABBY_LORA_PREAMBLE_LEN
	int "Preamble length in symbols"
	default 8

config ABBY_LORA_TX_POWER_DBM
	int "Transmit power (dBm)"
	default 14
	help
	  The Daphnis-I front end is the STM32WL's low-power PA and is
	  specified to +14 dBm, so values above that buy nothing.

config ABBY_LORA_PUBLIC_NETWORK
	bool "Use the public-network sync word"
	help
	  Leave this off for a point-to-point link. The public sync word is
	  for LoRaWAN-style traffic.

config ABBY_DUTY_CYCLE_ENFORCE
	bool "Enforce a transmit duty-cycle budget"
	depends on ABBY_ROLE_RELAY
	default y
	help
	  Spaces transmissions so that time on air stays within
	  ABBY_DUTY_CYCLE_PERMILLE, using the radio driver's own airtime
	  calculation so the budget tracks the configured spreading factor,
	  bandwidth and frame length automatically. Turning this off will
	  transmit as fast as frames arrive, which is almost certainly
	  outside what your ISM band allows - bench use only.

config ABBY_DUTY_CYCLE_PERMILLE
	int "Transmit duty-cycle budget (per mille)"
	depends on ABBY_ROLE_RELAY
	range 1 1000
	default 10
	help
	  10 per mille is the 1 % limit that applies to most EU868 channels.
	  Note what this costs: a 70-byte frame at SF7/BW125 is ~130 ms on
	  air, so 1 % allows one frame roughly every 13 seconds. Raise the
	  rate by shrinking the frame or lowering the spreading factor
	  rather than by relaxing this.

config ABBY_DOWNLINK_STACK_SIZE
	int "Radio thread stack size (bytes)"
	default 2048
	help
	  Stack for the thread that owns the radio: the transmit worker in
	  the relay role, the receive worker in the receive role.

config ABBY_DOWNLINK_THREAD_PRIORITY
	int "Radio thread priority"
	default 10
	help
	  In the relay role this thread blocks for the whole airtime of a
	  packet, so keep it below the link receiver.

endmenu # LoRa downlink

menu "Stack link"

config ABBY_LINK_RX_RING_SIZE
	int "Receive ring buffer size (bytes)"
	depends on ABBY_ROLE_RELAY
	default 512
	help
	  Buffers bytes between the UART interrupt and the frame parser. It
	  needs to cover a few frames' worth of burst; overruns are counted
	  and reported by "abby status".

config ABBY_LINK_STACK_SIZE
	int "Link parser thread stack size (bytes)"
	depends on ABBY_ROLE_RELAY
	default 1024

config ABBY_LINK_THREAD_PRIORITY
	int "Link parser thread priority"
	depends on ABBY_ROLE_RELAY
	default 7
	help
	  Above the radio thread, so parsing keeps up with the UART while a
	  transmission is in flight.

endmenu # Stack link

config ABBY_LED_PULSE_MS
	int "Status LED pulse length (ms)"
	default 50

config ABBY_HEARTBEAT_SEC
	int "Heartbeat interval (s)"
	default 30
	range 1 3600

config ABBY_HEARTBEAT_LOG
	bool "Log counters on each heartbeat"
	default y
	help
	  Prints the link and downlink counters periodically. Harmless in
	  flight - it goes to the console UART on the debug header - and the
	  cheapest way to see on a bench that frames are moving.

config ABBY_SHELL
	bool "abby shell commands"
	depends on SHELL
	default y if SHELL
	help
	  Registers the "abby" command tree: status, and test to push a
	  synthetic frame into whichever output the role uses, so each path
	  can be proven before the other end of it exists.

endmenu
```

## sample.yaml
```
# Copyright (c) 2026 Auxspace e.V.
# SPDX-License-Identifier: Apache-2.0
#
# Lets Twister build the application in CI. abby has no automated runtime
# test: proving a role end to end needs real hardware on the other side of
# it, so these are build checks and the parser is exercised by hand (see
# the application doc). Both roles are built, because they share headers
# and a break in one is easy to miss from the other.
sample:
  description: AUX-Tel telemetry bridge between the stack UART and LoRa
  name: abby
common:
  build_only: true
  platform_allow:
    - tel65@1
  integration_platforms:
    - tel65@1
tests:
  app.default: {}
  app.debug:
    extra_overlay_confs:
      - debug.conf
  app.no_shell:
    extra_configs:
      - CONFIG_SHELL=n
      - CONFIG_ABBY_SHELL=n
  app.duty_cycle_off:
    extra_configs:
      - CONFIG_ABBY_DUTY_CYCLE_ENFORCE=n
      - CONFIG_ABBY_LORA_SF=12
  app.receive:
    extra_overlay_confs:
      - receive.conf
  app.receive_debug:
    extra_overlay_confs:
      - receive.conf
      - debug.conf
  app.receive_no_shell:
    extra_overlay_confs:
      - receive.conf
    extra_configs:
      - CONFIG_SHELL=n
      - CONFIG_ABBY_SHELL=n
```

## prj.conf
```kconfig
# Copyright (c) 2026 Auxspace e.V.
# SPDX-License-Identifier: Apache-2.0

CONFIG_LOG=y

# Console and shell land on the J5 debug header (USART1 on AUX-Tel); the
# stack UART stays reserved for telemetry frames.
CONFIG_CONSOLE=y
CONFIG_SERIAL=y
CONFIG_UART_CONSOLE=y

# The stack-link receiver drains the UART from its interrupt.
CONFIG_UART_INTERRUPT_DRIVEN=y

CONFIG_GPIO=y
CONFIG_CRC=y

# Sub-GHz radio
CONFIG_LORA=y

# Bring-up shell: "abby status" and "abby test".
CONFIG_SHELL=y
CONFIG_ABBY_SHELL=y
CONFIG_SHELL_LOG_BACKEND=n

CONFIG_MAIN_STACK_SIZE=1024
```

## debug.conf
```kconfig
# Copyright (c) 2026 Auxspace e.V.
# SPDX-License-Identifier: Apache-2.0
#
# Extra overlay for bench work:
#   west build -b tel65 abby -- -DEXTRA_CONF_FILE=debug.conf

CONFIG_ABBY_LOG_LEVEL_DBG=y
CONFIG_LOG_MODE_IMMEDIATE=y

CONFIG_THREAD_NAME=y
CONFIG_THREAD_ANALYZER=y
CONFIG_THREAD_ANALYZER_USE_PRINTK=y
CONFIG_THREAD_ANALYZER_AUTO=n

CONFIG_ASSERT=y
```

## receive.conf
```kconfig
# Copyright (c) 2026 Auxspace e.V.
# SPDX-License-Identifier: Apache-2.0
#
# Ground-side role: LoRa in, stack UART out.
#   west build -b tel65@1 abby -- -DEXTRA_CONF_FILE=receive.conf
#
# Everything about the radio stays at the application defaults, so a
# board built this way and one built without it are two ends of the same
# link by construction. Change a radio setting and both ends have to be
# rebuilt.

CONFIG_ABBY_ROLE_RECEIVE=y
```

## boards/tel65.overlay
```dts
/*
 * Copyright (c) 2026 Auxspace e.V.
 * SPDX-License-Identifier: Apache-2.0
 */

/ {
	chosen {
		/*
		 * Which AUX-Stack data connector carries the telemetry link.
		 * abby reads the UART out of this node's uart-bus phandle, so
		 * it never names a board-specific peripheral and works on any
		 * board exposing an auxspaceev,aux-stack-data-connector.
		 *
		 * On AUX-Tel both connectors are bridged to the same LPUART1,
		 * so either label resolves to the same UART.
		 */
		auxspace,stack-connector = &top_data_connector;
	};
};
```

## src/main.c
```c
/*
 * Copyright (c) 2026 Auxspace e.V.
 * SPDX-License-Identifier: Apache-2.0
 *
 * abby - the AUX-Tel telemetry bridge.
 *
 * AUX-Tel sits in the AUX-Stack next to a brain board (AUX-Core) and
 * owns the long-range link. abby is the firmware that makes it a bridge
 * between the stack data connector's UART and the LoRa radio, in
 * whichever direction ABBY_ROLE selects:
 *
 *   relay   - the flight role. Telemetry wire frames arrive from the
 *             brain board over the stack connector, and every frame that
 *             passes its CRC is relayed verbatim over LoRa.
 *   receive - the ground role. Frames arrive over LoRa and every one
 *             that validates is written verbatim to the stack
 *             connector's UART, for a brain board or a USB-serial
 *             adapter to consume.
 *
 * Relaying verbatim is the point. The frames are the same ones the UART
 * link backends in lib/telemetry emit, so a ground station already able
 * to decode an HC-12 downlink needs no change to decode this one, and
 * abby itself never has to learn a payload layout. It also means the two
 * roles compose: a receive-role board feeds a brain board exactly what a
 * directly wired relay would have.
 *
 * The two transports live in link.c (the stack UART) and downlink.c (the
 * radio); each one is a source in one role and a sink in the other.
 */

#include <zephyr/device.h>
#include <zephyr/kernel.h>
#include <zephyr/logging/log.h>

#include <zephyr/app_version.h>

#include "downlink.h"
#include "link.h"

LOG_MODULE_REGISTER(abby, CONFIG_ABBY_LOG_LEVEL);

#define ROLE_NAME (IS_ENABLED(CONFIG_ABBY_ROLE_RELAY) ? "relay" : "receive")

int main(void)
{
	int rc;

	LOG_INF("abby %s on %s, role %s", APP_VERSION_STRING,
		CONFIG_BOARD_TARGET, ROLE_NAME);

	/* Sink before source, in both roles: whichever transport carries
	 * frames out has to be ready before the one that brings them in
	 * starts delivering, or the first frames are dropped.
	 */
#if defined(CONFIG_ABBY_ROLE_RELAY)
	rc = downlink_init();
	if (rc) {
		LOG_ERR("radio init failed (%d)", rc);
		return rc;
	}

	rc = link_init();
	if (rc) {
		LOG_ERR("stack link init failed (%d)", rc);
		return rc;
	}

	LOG_INF("relaying stack telemetry to LoRa");
#else
	rc = link_init();
	if (rc) {
		LOG_ERR("stack link init failed (%d)", rc);
		return rc;
	}

	rc = downlink_init();
	if (rc) {
		LOG_ERR("radio init failed (%d)", rc);
		return rc;
	}

	LOG_INF("relaying LoRa telemetry to the stack connector");
#endif

	/* Everything runs in the link and radio threads. */
	while (1) {
		k_sleep(K_SECONDS(CONFIG_ABBY_HEARTBEAT_SEC));

		if (IS_ENABLED(CONFIG_ABBY_HEARTBEAT_LOG)) {
			struct link_stats ls;
			struct downlink_stats ds;

			link_get_stats(&ls);
			downlink_get_stats(&ds);

			if (IS_ENABLED(CONFIG_ABBY_ROLE_RELAY)) {
				LOG_INF("uart rx %u frames (%u crc, %u overrun) | "
					"lora tx %u (%u err, %u superseded)",
					ls.frames, ls.crc_errs, ls.overruns,
					ds.sent, ds.tx_errs, ds.superseded);
			} else {
				LOG_INF("lora rx %u frames (%u rejected, %u err) | "
					"uart tx %u | last RSSI %d dBm SNR %d dB",
					ds.received, ds.rejected, ds.rx_errs,
					ls.sent, ds.last_rssi, ds.last_snr);
			}
		}
	}

	return 0;
}
```

## src/abby_shell.c
```c
/*
 * Copyright (c) 2026 Auxspace e.V.
 * SPDX-License-Identifier: Apache-2.0
 *
 * Bench shell for the bridge. "abby test" exists so each half can be
 * proven on its own, before the other end of it exists: it pushes a
 * synthetic frame into whichever output the role owns - the radio in the
 * relay role, the stack UART in the receive role.
 */

#include <stdlib.h>

#include <zephyr/kernel.h>
#include <zephyr/shell/shell.h>

#include <aurora/lib/telemetry/wire.h>

#include "downlink.h"
#include "link.h"

static int cmd_status(const struct shell *sh, size_t argc, char **argv)
{
	struct link_stats ls;
	struct downlink_stats ds;

	ARG_UNUSED(argc);
	ARG_UNUSED(argv);

	link_get_stats(&ls);
	downlink_get_stats(&ds);

	shell_print(sh, "role              : %s",
		    IS_ENABLED(CONFIG_ABBY_ROLE_RELAY)
			    ? "relay (stack UART -> LoRa)"
			    : "receive (LoRa -> stack UART)");

	/* Every one of these has to match at the other end of the link, and
	 * a mismatch is indistinguishable from a dead radio, so make them
	 * easy to compare between two boards.
	 */
	shell_print(sh, "radio             : %u Hz, SF%d, BW%d kHz, CR4/%d, "
			"%s sync",
		    (unsigned int)CONFIG_ABBY_LORA_FREQ_HZ,
		    CONFIG_ABBY_LORA_SF, CONFIG_ABBY_LORA_BW_KHZ,
		    CONFIG_ABBY_LORA_CODING_RATE + 4,
		    IS_ENABLED(CONFIG_ABBY_LORA_PUBLIC_NETWORK) ? "public"
								: "private");

#if defined(CONFIG_ABBY_ROLE_RELAY)
	shell_print(sh, "stack link (in):");
	shell_print(sh, "  frames accepted : %u", ls.frames);
	shell_print(sh, "  CRC errors      : %u", ls.crc_errs);
	shell_print(sh, "  ring overruns   : %u B", ls.overruns);
	shell_print(sh, "lora radio (out):");
	shell_print(sh, "  frames sent     : %u", ds.sent);
	shell_print(sh, "  send errors     : %u", ds.tx_errs);
	shell_print(sh, "  superseded      : %u", ds.superseded);
	shell_print(sh, "  oversize        : %u", ds.oversize);
	shell_print(sh, "  last airtime    : %u ms", ds.last_air_ms);
	shell_print(sh, "  duty cycle      : %s (%d.%d%%)",
		    IS_ENABLED(CONFIG_ABBY_DUTY_CYCLE_ENFORCE) ? "enforced"
							       : "OFF",
		    CONFIG_ABBY_DUTY_CYCLE_PERMILLE / 10,
		    CONFIG_ABBY_DUTY_CYCLE_PERMILLE % 10);
#else
	shell_print(sh, "lora radio (in):");
	shell_print(sh, "  frames received : %u", ds.received);
	shell_print(sh, "  rejected        : %u", ds.rejected);
	shell_print(sh, "  recv errors     : %u", ds.rx_errs);
	shell_print(sh, "  last RSSI       : %d dBm", ds.last_rssi);
	shell_print(sh, "  last SNR        : %d dB", ds.last_snr);
	shell_print(sh, "stack link (out):");
	shell_print(sh, "  frames written  : %u", ls.sent);
#endif

	return 0;
}

static int cmd_test(const struct shell *sh, size_t argc, char **argv)
{
	uint8_t payload_len = 16;
	uint8_t frame[AURORA_TELEMETRY_WIRE_MAX_FRAME];

	if (argc > 1) {
		long n = strtol(argv[1], NULL, 0);

		if (n < 0 || n > AURORA_TELEMETRY_WIRE_MAX_PAYLOAD) {
			shell_error(sh, "payload length out of range (0..%d)",
				    AURORA_TELEMETRY_WIRE_MAX_PAYLOAD);
			return -EINVAL;
		}
		payload_len = (uint8_t)n;
	}

	uint8_t payload[AURORA_TELEMETRY_WIRE_MAX_PAYLOAD];

	for (uint8_t i = 0; i < payload_len; i++) {
		payload[i] = i;
	}

	/* Built with the same helper the senders use, so a frame that
	 * passes here is a frame the parser must accept.
	 */
	size_t len = telemetry_wire_finalise(
		frame, sizeof(frame), AURORA_TELEMETRY_WIRE_TYPE_SM_UPDATE,
		payload, payload_len);

	if (len == 0) {
		shell_error(sh, "frame build failed");
		return -EINVAL;
	}

#if defined(CONFIG_ABBY_ROLE_RELAY)
	int rc = downlink_submit(frame, len);

	if (rc) {
		shell_error(sh, "submit failed (%d)", rc);
		return rc;
	}

	shell_print(sh, "queued a %u byte test frame for the radio; "
			"a duty-cycle wait may delay it", (unsigned int)len);
#else
	int rc = link_send(frame, len);

	if (rc) {
		shell_error(sh, "write failed (%d)", rc);
		return rc;
	}

	shell_print(sh, "wrote a %u byte test frame to the stack UART",
		    (unsigned int)len);
#endif

	return 0;
}

SHELL_STATIC_SUBCMD_SET_CREATE(abby_cmds,
	SHELL_CMD(status, NULL, "Show link and radio counters", cmd_status),
	SHELL_CMD_ARG(test, NULL,
		      "Push a synthetic frame into this role's output: "
		      "test [payload_len]",
		      cmd_test, 1, 1),
	SHELL_SUBCMD_SET_END
);

SHELL_CMD_REGISTER(abby, &abby_cmds, "AUX-Tel telemetry bridge", NULL);
```

## src/downlink.c
```c
/*
 * Copyright (c) 2026 Auxspace e.V.
 * SPDX-License-Identifier: Apache-2.0
 *
 * The LoRa radio: whichever end of the AUX-Tel air link this firmware
 * is. The roles are mirror images.
 *
 *   relay   - frames arrive from the stack UART and go out over the air.
 *   receive - frames arrive over the air and go out to the stack UART.
 *
 * Both are built from the same radio Kconfig on purpose. A LoRa packet
 * only demodulates when both ends agree on frequency, spreading factor
 * and bandwidth, and a mismatch is invisible - it looks exactly like no
 * transmitter at all - so the two ends share one set of defaults rather
 * than two that can drift apart.
 *
 * Two properties shape the relay direction:
 *
 *   - Frames go out verbatim. The relay never parses a payload, so the
 *     ground station sees the same bytes whether they arrived over an
 *     HC-12 or over this board, and new packet types need no change
 *     here.
 *   - Airtime, not frame rate, is the scarce resource. A 70-byte frame
 *     at SF7/BW125 is about 130 ms on air, and a 1 % duty cycle then
 *     allows one frame every ~13 s. The transmit worker therefore
 *     budgets from the driver's own lora_airtime() and keeps only the
 *     newest frame while it waits, so what finally goes out is the
 *     freshest state rather than a stale backlog.
 *
 * The receive direction needs none of that: a LoRa packet carries its
 * own boundaries, so a received frame is whole or absent, and there is
 * no duty cycle on listening.
 */

#include <string.h>

#include <zephyr/device.h>
#include <zephyr/devicetree.h>
#include <zephyr/drivers/gpio.h>
#include <zephyr/drivers/lora.h>
#include <zephyr/kernel.h>
#include <zephyr/logging/log.h>
#include <zephyr/sys/atomic.h>

#include <aurora/lib/telemetry/wire.h>

#include "downlink.h"
#include "link.h"

LOG_MODULE_REGISTER(abby_downlink, CONFIG_ABBY_LOG_LEVEL);

#define LORA_NODE DT_ALIAS(lora0)

BUILD_ASSERT(DT_NODE_HAS_STATUS_OKAY(LORA_NODE),
	     "No enabled lora0 alias: this application needs a radio");

static const struct device *const lora_dev = DEVICE_DT_GET(LORA_NODE);

/* SX126x-class radios cap a single packet at 255 bytes. */
#define LORA_MAX_PAYLOAD 255

static struct {
	atomic_t sent;
	atomic_t tx_errs;
	atomic_t superseded;
	atomic_t oversize;
	atomic_t last_air_ms;
	atomic_t received;
	atomic_t rejected;
	atomic_t rx_errs;
	atomic_t last_rssi;
	atomic_t last_snr;
} stats;

/* Radio-activity LED. It means the same thing in both roles: this board
 * just used the air. link.c owns led1 for the stack UART side.
 */
#if DT_NODE_EXISTS(DT_ALIAS(led0))
static const struct gpio_dt_spec radio_led =
	GPIO_DT_SPEC_GET(DT_ALIAS(led0), gpios);
#endif

static inline void radio_led_set(int on)
{
#if DT_NODE_EXISTS(DT_ALIAS(led0))
	if (radio_led.port) {
		(void)gpio_pin_set_dt(&radio_led, on);
	}
#else
	ARG_UNUSED(on);
#endif
}

#if defined(CONFIG_ABBY_ROLE_RELAY)

/* Newest-frame slot. A deeper queue would only let the radio fall
 * further behind real time.
 */
static struct {
	uint8_t buf[AURORA_TELEMETRY_WIRE_MAX_FRAME];
	uint16_t len;
} slot;

static K_MUTEX_DEFINE(slot_lock);
static K_SEM_DEFINE(slot_sem, 0, 1);

int downlink_submit(const uint8_t *frame, size_t len)
{
	if (!frame || len == 0) {
		return -EINVAL;
	}

	if (len > LORA_MAX_PAYLOAD) {
		atomic_inc(&stats.oversize);
		return -EMSGSIZE;
	}

	k_mutex_lock(&slot_lock, K_FOREVER);
	if (slot.len != 0) {
		atomic_inc(&stats.superseded);
	}
	memcpy(slot.buf, frame, len);
	slot.len = (uint16_t)len;
	k_mutex_unlock(&slot_lock);

	k_sem_give(&slot_sem);
	return 0;
}

static void transmit_thread(void *a, void *b, void *c)
{
	/* Earliest uptime at which a transmission may start, from the
	 * duty-cycle budget of the previous one.
	 */
	int64_t next_tx_ms = 0;

	ARG_UNUSED(a);
	ARG_UNUSED(b);
	ARG_UNUSED(c);

	while (1) {
		(void)k_sem_take(&slot_sem, K_FOREVER);

		/* Wait out the budget *before* taking a frame, so a frame
		 * that arrives during the wait supersedes the one that
		 * triggered it.
		 */
		if (IS_ENABLED(CONFIG_ABBY_DUTY_CYCLE_ENFORCE)) {
			int64_t wait_ms = next_tx_ms - k_uptime_get();

			if (wait_ms > 0) {
				k_sleep(K_MSEC(wait_ms));
			}
		}

		uint8_t buf[AURORA_TELEMETRY_WIRE_MAX_FRAME];
		uint16_t len;

		k_mutex_lock(&slot_lock, K_FOREVER);
		len = slot.len;
		if (len) {
			memcpy(buf, slot.buf, len);
			slot.len = 0;
		}
		k_mutex_unlock(&slot_lock);

		if (len == 0) {
			continue;
		}

		uint32_t air_ms = lora_airtime(lora_dev, len);
		int64_t started = k_uptime_get();

		radio_led_set(1);
		int rc = lora_send(lora_dev, buf, len);
		radio_led_set(0);

		if (rc < 0) {
			atomic_inc(&stats.tx_errs);
			LOG_ERR("lora_send of %u bytes failed (%d)", len, rc);
		} else {
			atomic_inc(&stats.sent);
			atomic_set(&stats.last_air_ms, (atomic_val_t)air_ms);
			LOG_DBG("sent %u bytes, %u ms airtime", len, air_ms);
		}

		/* The duty-cycle window opens at the start of a
		 * transmission: period = airtime / duty.
		 */
		next_tx_ms = started +
			     (int64_t)air_ms * 1000 /
				     CONFIG_ABBY_DUTY_CYCLE_PERMILLE;
	}
}

K_THREAD_DEFINE(abby_downlink_tid, CONFIG_ABBY_DOWNLINK_STACK_SIZE,
		transmit_thread, NULL, NULL, NULL,
		CONFIG_ABBY_DOWNLINK_THREAD_PRIORITY, 0, 0);

#else /* CONFIG_ABBY_ROLE_RECEIVE */

/* lora_recv() takes its buffer size as a uint8_t, so 255 is the hard
 * ceiling - which is also the largest packet an SX126x can carry, and
 * therefore the largest frame any relay could have put on the air
 * (downlink_submit() rejects more). Passing the 261-byte MAX_FRAME here
 * would silently truncate to 5.
 *
 * File scope rather than stack: only this thread touches it, and it
 * keeps a 255-byte buffer out of the thread's stack budget.
 */
static uint8_t rx_buf[LORA_MAX_PAYLOAD];

BUILD_ASSERT(sizeof(rx_buf) <= UINT8_MAX,
	     "lora_recv() takes the buffer size as a uint8_t");

/* The worker is started by the kernel at boot, before main() has run
 * lora_config(), so it waits here for the radio to be configured. The
 * relay role needs no equivalent: its worker blocks on an empty frame
 * slot anyway. If init fails this is never given and the thread simply
 * never touches the radio.
 */
static K_SEM_DEFINE(radio_ready, 0, 1);

static void rx_led_off(struct k_work *work)
{
	ARG_UNUSED(work);
	radio_led_set(0);
}

static K_WORK_DELAYABLE_DEFINE(rx_led_work, rx_led_off);

static void rx_led_pulse(void)
{
	radio_led_set(1);
	(void)k_work_reschedule(&rx_led_work,
				K_MSEC(CONFIG_ABBY_LED_PULSE_MS));
}

static void receive_thread(void *a, void *b, void *c)
{
	ARG_UNUSED(a);
	ARG_UNUSED(b);
	ARG_UNUSED(c);

	(void)k_sem_take(&radio_ready, K_FOREVER);

	while (1) {
		int16_t rssi = 0;
		int8_t snr = 0;
		int len = lora_recv(lora_dev, rx_buf, sizeof(rx_buf),
				    K_FOREVER, &rssi, &snr);

		if (len <= 0) {
			if (len < 0) {
				atomic_inc(&stats.rx_errs);
				LOG_ERR("lora_recv failed (%d)", len);
			}
			/* The sleep also keeps this off a hot loop if CAD is
			 * ever configured, where lora_recv() returns 0 as
			 * soon as it finds the channel idle.
			 */
			k_sleep(K_MSEC(100));
			continue;
		}

		/* A LoRa packet is delivered whole, so there is no partial
		 * frame to reassemble: the packet either is a frame or it
		 * is not ours. The radio's own CRC has already rejected
		 * corrupted packets, so anything landing here with a bad
		 * frame CRC is far more likely to be a foreign transmitter
		 * on the same channel.
		 */
		if (!telemetry_wire_validate(rx_buf, (size_t)len)) {
			atomic_inc(&stats.rejected);
			LOG_WRN("rejected a %d byte packet (RSSI %d dBm)",
				len, rssi);
			continue;
		}

		atomic_inc(&stats.received);
		atomic_set(&stats.last_rssi, (atomic_val_t)rssi);
		atomic_set(&stats.last_snr, (atomic_val_t)snr);
		rx_led_pulse();

		LOG_DBG("received frame type %u, %d bytes, RSSI %d dBm, SNR %d dB",
			rx_buf[2], len, rssi, snr);

		int rc = link_send(rx_buf, (size_t)len);

		if (rc) {
			LOG_ERR("forwarding a %d byte frame to the stack UART "
				"failed (%d)", len, rc);
		}
	}
}

K_THREAD_DEFINE(abby_downlink_tid, CONFIG_ABBY_DOWNLINK_STACK_SIZE,
		receive_thread, NULL, NULL, NULL,
		CONFIG_ABBY_DOWNLINK_THREAD_PRIORITY, 0, 0);

#endif /* CONFIG_ABBY_ROLE_* */

void downlink_get_stats(struct downlink_stats *out)
{
	if (!out) {
		return;
	}
	out->sent = (uint32_t)atomic_get(&stats.sent);
	out->tx_errs = (uint32_t)atomic_get(&stats.tx_errs);
	out->superseded = (uint32_t)atomic_get(&stats.superseded);
	out->oversize = (uint32_t)atomic_get(&stats.oversize);
	out->last_air_ms = (uint32_t)atomic_get(&stats.last_air_ms);
	out->received = (uint32_t)atomic_get(&stats.received);
	out->rejected = (uint32_t)atomic_get(&stats.rejected);
	out->rx_errs = (uint32_t)atomic_get(&stats.rx_errs);
	out->last_rssi = (int16_t)atomic_get(&stats.last_rssi);
	out->last_snr = (int8_t)atomic_get(&stats.last_snr);
}

int downlink_init(void)
{
	struct lora_modem_config config = {
		.frequency = CONFIG_ABBY_LORA_FREQ_HZ,
		.bandwidth = (enum lora_signal_bandwidth)CONFIG_ABBY_LORA_BW_KHZ,
		.datarate = (enum lora_datarate)CONFIG_ABBY_LORA_SF,
		.coding_rate = (enum lora_coding_rate)CONFIG_ABBY_LORA_CODING_RATE,
		.preamble_len = CONFIG_ABBY_LORA_PREAMBLE_LEN,
		.tx_power = CONFIG_ABBY_LORA_TX_POWER_DBM,
		.tx = IS_ENABLED(CONFIG_ABBY_ROLE_RELAY),
		.iq_inverted = false,
		.public_network = IS_ENABLED(CONFIG_ABBY_LORA_PUBLIC_NETWORK),
	};

	if (!device_is_ready(lora_dev)) {
		LOG_ERR("radio %s not ready", lora_dev->name);
		return -ENODEV;
	}

#if DT_NODE_EXISTS(DT_ALIAS(led0))
	if (radio_led.port && gpio_is_ready_dt(&radio_led)) {
		(void)gpio_pin_configure_dt(&radio_led, GPIO_OUTPUT_INACTIVE);
	}
#endif

	int rc = lora_config(lora_dev, &config);

	if (rc < 0) {
		LOG_ERR("lora_config failed (%d)", rc);
		return rc;
	}

	/* Logged on one line, and deliberately verbose: every one of these
	 * has to match at the other end, and this is the cheapest way to
	 * compare two boards.
	 */
	LOG_INF("radio up for %s: %u Hz, SF%d, BW%d kHz, CR4/%d, %s sync%s",
		IS_ENABLED(CONFIG_ABBY_ROLE_RELAY) ? "transmit" : "receive",
		(unsigned int)CONFIG_ABBY_LORA_FREQ_HZ,
		CONFIG_ABBY_LORA_SF, CONFIG_ABBY_LORA_BW_KHZ,
		CONFIG_ABBY_LORA_CODING_RATE + 4,
		IS_ENABLED(CONFIG_ABBY_LORA_PUBLIC_NETWORK) ? "public"
							    : "private",
		IS_ENABLED(CONFIG_ABBY_ROLE_RELAY) ? "" : ", listening");

#if defined(CONFIG_ABBY_ROLE_RELAY)
	LOG_INF("transmitting at %d dBm", CONFIG_ABBY_LORA_TX_POWER_DBM);

	if (IS_ENABLED(CONFIG_ABBY_DUTY_CYCLE_ENFORCE)) {
		LOG_INF("duty cycle capped at %d.%d%%",
			CONFIG_ABBY_DUTY_CYCLE_PERMILLE / 10,
			CONFIG_ABBY_DUTY_CYCLE_PERMILLE % 10);
	} else {
		LOG_WRN("duty-cycle budget DISABLED - bench use only");
	}
#else
	/* Release the receive worker now that the radio is configured. */
	k_sem_give(&radio_ready);
#endif

	return 0;
}
```

## src/downlink.h
```c
/*
 * Copyright (c) 2026 Auxspace e.V.
 * SPDX-License-Identifier: Apache-2.0
 */

#ifndef ABBY_DOWNLINK_H_
#define ABBY_DOWNLINK_H_

#include <stddef.h>
#include <stdint.h>

/**
 * @brief Counters for the LoRa radio.
 *
 * Which half is populated depends on the role: the transmit counters in
 * the relay role, the receive counters in the receive role. The other
 * half stays zero.
 */
struct downlink_stats {
	/* Relay role (transmitting). */
	uint32_t sent;        /**< Frames transmitted. */
	uint32_t tx_errs;     /**< lora_send() failures. */
	uint32_t superseded;  /**< Frames dropped because a newer one arrived. */
	uint32_t oversize;    /**< Frames too large for one LoRa packet. */
	uint32_t last_air_ms; /**< Airtime of the most recent transmission. */

	/* Receive role. */
	uint32_t received;    /**< Packets accepted as valid frames. */
	uint32_t rejected;    /**< Packets failing magic, length or CRC. */
	uint32_t rx_errs;     /**< lora_recv() failures. */
	int16_t  last_rssi;   /**< RSSI of the last accepted frame, dBm. */
	int8_t   last_snr;    /**< SNR of the last accepted frame, dB. */
};

/**
 * @brief Configure the radio for this role.
 *
 * In the relay role this readies the radio for transmission. In the
 * receive role it also starts the receive worker, so call it only once
 * the UART sink is up.
 *
 * @retval 0 on success.
 * @retval -ENODEV if the radio is not ready.
 * @retval <0 as returned by lora_config().
 */
int downlink_init(void);

/**
 * @brief Hand a complete, CRC-checked frame to the radio.
 *
 * Relay role only. Never blocks. Only the newest frame is kept: if one
 * is already waiting it is replaced, because a telemetry downlink wants
 * the freshest state rather than a backlog.
 *
 * @param frame Frame bytes, starting at magic0.
 * @param len   Frame length in bytes.
 *
 * @retval 0 on success.
 * @retval -EMSGSIZE if @p len exceeds one LoRa packet.
 */
int downlink_submit(const uint8_t *frame, size_t len);

/** @brief Snapshot the radio counters. */
void downlink_get_stats(struct downlink_stats *out);

#endif /* ABBY_DOWNLINK_H_ */
```

## src/link.c
```c
/*
 * Copyright (c) 2026 Auxspace e.V.
 * SPDX-License-Identifier: Apache-2.0
 *
 * The AUX-Stack data-connector UART: the wire to the brain board.
 *
 * Which direction it runs depends on the role.
 *
 *   relay   - drains the UART and reassembles telemetry wire frames out
 *             of the byte stream, handing each one to the radio.
 *   receive - writes frames that arrived over the air back out as the
 *             same byte stream, so whatever is attached sees exactly
 *             what a directly wired sender would have produced.
 *
 * Both directions are payload-agnostic: the magic pair and the CRC are
 * validated, and the frame then travels on verbatim, so a new packet
 * type reaches its destination without this relay having to know
 * anything about it.
 */

#include <zephyr/device.h>
#include <zephyr/devicetree.h>
#include <zephyr/drivers/gpio.h>
#include <zephyr/drivers/uart.h>
#include <zephyr/kernel.h>
#include <zephyr/logging/log.h>
#include <zephyr/sys/atomic.h>
#include <zephyr/sys/byteorder.h>
#include <zephyr/sys/ring_buffer.h>

#include <aurora/lib/telemetry/wire.h>

#include "downlink.h"
#include "link.h"

LOG_MODULE_REGISTER(abby_link, CONFIG_ABBY_LOG_LEVEL);

/* The connector binding carries the phandle of whichever UART the board
 * wires to the data connector's TXD/RXD pins, so this file never names a
 * board-specific peripheral.
 */
#define STACK_CONNECTOR DT_CHOSEN(auxspace_stack_connector)

BUILD_ASSERT(DT_NODE_EXISTS(STACK_CONNECTOR),
	     "Set the auxspace,stack-connector chosen node to an "
	     "auxspaceev,aux-stack-data-connector node");
BUILD_ASSERT(DT_NODE_HAS_PROP(STACK_CONNECTOR, uart_bus),
	     "The chosen auxspace,stack-connector has no uart-bus property");

#define STACK_UART_NODE DT_PHANDLE(STACK_CONNECTOR, uart_bus)

BUILD_ASSERT(DT_NODE_HAS_STATUS_OKAY(STACK_UART_NODE),
	     "The stack connector's uart-bus is disabled");

static const struct device *const stack_uart = DEVICE_DT_GET(STACK_UART_NODE);

static struct {
	atomic_t frames;
	atomic_t crc_errs;
	atomic_t overruns;
	atomic_t sent;
} stats;

/* Stack-link activity LED. It means the same thing in both roles: a
 * frame just crossed the connector. downlink.c owns led0 for the radio.
 */
#if DT_NODE_EXISTS(DT_ALIAS(led1))
static const struct gpio_dt_spec link_led =
	GPIO_DT_SPEC_GET(DT_ALIAS(led1), gpios);

static void link_led_off(struct k_work *work)
{
	ARG_UNUSED(work);
	(void)gpio_pin_set_dt(&link_led, 0);
}

static K_WORK_DELAYABLE_DEFINE(link_led_work, link_led_off);

static void link_led_pulse(void)
{
	if (!link_led.port) {
		return;
	}
	(void)gpio_pin_set_dt(&link_led, 1);
	(void)k_work_reschedule(&link_led_work,
				K_MSEC(CONFIG_ABBY_LED_PULSE_MS));
}
#else
static void link_led_pulse(void) { }
#endif

#if defined(CONFIG_ABBY_ROLE_RELAY)

RING_BUF_DECLARE(rx_rb, CONFIG_ABBY_LINK_RX_RING_SIZE);
static K_SEM_DEFINE(rx_sem, 0, 1);

static void uart_isr(const struct device *dev, void *user_data)
{
	uint8_t buf[32];

	ARG_UNUSED(user_data);

	/* uart_irq_update() returns void here; it only latches the
	 * pending-interrupt state that the rx_ready query below reads.
	 */
	uart_irq_update(dev);

	while (uart_irq_rx_ready(dev)) {
		int n = uart_fifo_read(dev, buf, sizeof(buf));

		if (n <= 0) {
			break;
		}

		uint32_t put = ring_buf_put(&rx_rb, buf, (uint32_t)n);

		if (put < (uint32_t)n) {
			atomic_add(&stats.overruns, (uint32_t)n - put);
		}
		k_sem_give(&rx_sem);
	}
}

/* Frame reassembly state. Only touched by the parser thread.
 *
 * Resynchronisation is magic-pair plus CRC, with one consequence worth
 * knowing: a truncated frame leaves the parser mid-payload, so it eats a
 * frame's worth of the following bytes before it can look for a sync pair
 * again, and the frame after a truncation can be lost. That is inherent to
 * this style of framing rather than a defect, and it costs nothing here -
 * the sender writes whole frames under a mutex, and the duty-cycle budget
 * puts seconds between them.
 */
enum parse_state {
	P_MAGIC0 = 0,
	P_MAGIC1,
	P_TYPE,
	P_LEN,
	P_PAYLOAD,
	P_CRC_LO,
	P_CRC_HI,
};

static enum parse_state pstate;
static uint8_t frame[AURORA_TELEMETRY_WIRE_MAX_FRAME];
static uint16_t fidx;
static uint8_t payload_len;

static void frame_complete(void)
{
	uint16_t want = telemetry_wire_crc(frame, payload_len);
	uint16_t got = sys_get_le16(
		&frame[AURORA_TELEMETRY_WIRE_HDR_LEN + payload_len]);

	if (want != got) {
		atomic_inc(&stats.crc_errs);
		LOG_WRN("CRC mismatch (want %04x got %04x), resyncing",
			want, got);
		return;
	}

	atomic_inc(&stats.frames);
	LOG_DBG("frame type %u, %u byte payload", frame[2], payload_len);
	link_led_pulse();

	int rc = downlink_submit(frame, fidx);

	if (rc == -EMSGSIZE) {
		LOG_WRN("frame of %u bytes exceeds one LoRa packet", fidx);
	}
}

static void parse_byte(uint8_t b)
{
	switch (pstate) {
	case P_MAGIC0:
		if (b == AURORA_TELEMETRY_WIRE_MAGIC0) {
			frame[0] = b;
			pstate = P_MAGIC1;
		}
		break;

	case P_MAGIC1:
		if (b == AURORA_TELEMETRY_WIRE_MAGIC1) {
			frame[1] = b;
			pstate = P_TYPE;
		} else if (b != AURORA_TELEMETRY_WIRE_MAGIC0) {
			/* Not a sync pair; but a repeated magic0 could still
			 * be the real start, so only give up otherwise.
			 */
			pstate = P_MAGIC0;
		}
		break;

	case P_TYPE:
		frame[2] = b;
		pstate = P_LEN;
		break;

	case P_LEN:
		frame[3] = b;
		payload_len = b;
		fidx = AURORA_TELEMETRY_WIRE_HDR_LEN;
		pstate = (payload_len == 0) ? P_CRC_LO : P_PAYLOAD;
		break;

	case P_PAYLOAD:
		frame[fidx++] = b;
		if (fidx == (uint16_t)AURORA_TELEMETRY_WIRE_HDR_LEN +
				    payload_len) {
			pstate = P_CRC_LO;
		}
		break;

	case P_CRC_LO:
		frame[fidx++] = b;
		pstate = P_CRC_HI;
		break;

	case P_CRC_HI:
		frame[fidx++] = b;
		frame_complete();
		pstate = P_MAGIC0;
		break;
	}
}

static void link_thread(void *a, void *b, void *c)
{
	ARG_UNUSED(a);
	ARG_UNUSED(b);
	ARG_UNUSED(c);

	while (1) {
		(void)k_sem_take(&rx_sem, K_FOREVER);

		uint8_t byte;

		while (ring_buf_get(&rx_rb, &byte, 1) == 1) {
			parse_byte(byte);
		}
	}
}

K_THREAD_DEFINE(abby_link_tid, CONFIG_ABBY_LINK_STACK_SIZE,
		link_thread, NULL, NULL, NULL,
		CONFIG_ABBY_LINK_THREAD_PRIORITY, 0, 0);

#else /* CONFIG_ABBY_ROLE_RECEIVE */

static K_MUTEX_DEFINE(tx_lock);

int link_send(const uint8_t *frame, size_t len)
{
	if (!frame || len == 0) {
		return -EINVAL;
	}

	/* uart_poll_out() busy-waits a character at a time, so the lock is
	 * held for the whole frame rather than per byte: a frame
	 * interleaved with another is unparseable at the far end, where a
	 * late one is merely late. The radio worker and the shell's test
	 * command are the two callers that can collide here.
	 */
	k_mutex_lock(&tx_lock, K_FOREVER);
	for (size_t i = 0; i < len; i++) {
		uart_poll_out(stack_uart, frame[i]);
	}
	k_mutex_unlock(&tx_lock);

	atomic_inc(&stats.sent);
	link_led_pulse();

	LOG_DBG("wrote %u bytes to %s", (unsigned int)len, stack_uart->name);
	return 0;
}

#endif /* CONFIG_ABBY_ROLE_* */

void link_get_stats(struct link_stats *out)
{
	if (!out) {
		return;
	}
	out->frames = (uint32_t)atomic_get(&stats.frames);
	out->crc_errs = (uint32_t)atomic_get(&stats.crc_errs);
	out->overruns = (uint32_t)atomic_get(&stats.overruns);
	out->sent = (uint32_t)atomic_get(&stats.sent);
}

int link_init(void)
{
	if (!device_is_ready(stack_uart)) {
		LOG_ERR("stack UART %s not ready", stack_uart->name);
		return -ENODEV;
	}

#if DT_NODE_EXISTS(DT_ALIAS(led1))
	if (link_led.port && gpio_is_ready_dt(&link_led)) {
		(void)gpio_pin_configure_dt(&link_led, GPIO_OUTPUT_INACTIVE);
	}
#endif

#if defined(CONFIG_ABBY_ROLE_RELAY)
	uart_irq_callback_user_data_set(stack_uart, uart_isr, NULL);
	uart_irq_rx_enable(stack_uart);

	LOG_INF("stack link up on %s, listening for frames",
		stack_uart->name);
#else
	LOG_INF("stack link up on %s, writing received frames out",
		stack_uart->name);
#endif

	return 0;
}
```

## src/link.h
```c
/*
 * Copyright (c) 2026 Auxspace e.V.
 * SPDX-License-Identifier: Apache-2.0
 */

#ifndef ABBY_LINK_H_
#define ABBY_LINK_H_

#include <stddef.h>
#include <stdint.h>

/**
 * @brief Counters for the AUX-Stack connector UART.
 *
 * Which half is populated depends on the role: the receive counters in
 * the relay role, @c sent in the receive role.
 */
struct link_stats {
	uint32_t frames;    /**< Frames accepted (magic and CRC good). */
	uint32_t crc_errs;  /**< Frames discarded on a CRC mismatch. */
	uint32_t overruns;  /**< Bytes dropped because the ring buffer was full. */
	uint32_t sent;      /**< Frames written out to the UART. */
};

/**
 * @brief Bring up the stack UART.
 *
 * In the relay role this also installs the receive interrupt and starts
 * the frame parser, so call it only once the radio is up.
 *
 * @retval 0 on success.
 * @retval -ENODEV if the UART is not ready.
 */
int link_init(void);

/**
 * @brief Write a complete frame out to the stack UART.
 *
 * Receive role only. Blocks for the frame's transmission time - about
 * 6 ms for a 70-byte frame at 115200 baud - and serialises against
 * other callers so a frame is never interleaved with another.
 *
 * @param frame Frame bytes, starting at magic0.
 * @param len   Frame length in bytes.
 *
 * @retval 0 on success.
 * @retval -EINVAL if @p frame is NULL or @p len is zero.
 */
int link_send(const uint8_t *frame, size_t len);

/** @brief Snapshot the link counters. */
void link_get_stats(struct link_stats *out);

#endif /* ABBY_LINK_H_ */
```
